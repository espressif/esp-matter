/*
   This example code is in the Public Domain (or CC0 licensed, at your option.)

   Unless required by applicable law or agreed to in writing, this
   software is distributed on an "AS IS" BASIS, WITHOUT WARRANTIES OR
   CONDITIONS OF ANY KIND, either express or implied.
*/

#include "matter_signaling.h"
#include "webrtc-provider-manager.h"
#include "webrtc-transport.h"
#include "app_webrtc_if.h"
#include "esp_log.h"
#include <string.h>
#include <new>
#include <platform/CHIPDeviceLayer.h>

static const char *TAG = "matter_sig_bridge";

// Structure to hold string data for lambda capture (must be trivially copyable)
// We allocate this on the heap and capture only a pointer to meet lambda size constraints
struct StringData {
    char *data;
    size_t len;
};

using namespace chip;
using namespace chip::app;
using namespace chip::app::Clusters;
using namespace chip::app::Clusters::WebRTCTransportProvider;

/**
 * @brief Extract a JSON string value for the given key from a simple flat JSON object.
 *
 * Handles the exact JSON format produced by KVS serializeSessionDescriptionInit and
 * onIceCandidateHandler, e.g.:
 *   {"type": "answer", "sdp": "v=0\\r\\n..."}
 *   {"candidate": "candidate:..."}
 *
 * Performs JSON unescaping of the extracted value so callers receive the raw string.
 */
static std::string extract_json_string(const char *json, const char *key)
{
    if (!json || !key) {
        return std::string();
    }

    // Build key search pattern: "key":
    char search[64];
    snprintf(search, sizeof(search), "\"%s\":", key);

    const char *pos = strstr(json, search);
    if (!pos) {
        // Try with a space before the colon: "key" :
        snprintf(search, sizeof(search), "\"%s\" :", key);
        pos = strstr(json, search);
        if (!pos) {
            return std::string();
        }
    }
    pos += strlen(search);

    // Skip optional whitespace between ':' and '"'
    while (*pos == ' ' || *pos == '\t') {
        pos++;
    }

    // Expect opening quote
    if (*pos != '"') {
        return std::string();
    }
    pos++;

    // Read until closing unescaped quote, performing JSON unescaping
    std::string result;
    while (*pos) {
        if (*pos == '\\' && *(pos + 1)) {
            pos++;
            switch (*pos) {
            case '"':  result += '"';  break;
            case '\\': result += '\\'; break;
            case 'n':  result += '\n'; break;
            case 'r':  result += '\r'; break;
            case 't':  result += '\t'; break;
            case 'b':  result += '\b'; break;
            case 'f':  result += '\f'; break;
            default:   result += *pos; break;
            }
        } else if (*pos == '"') {
            break; // End of string value
        } else {
            result += *pos;
        }
        pos++;
    }
    return result;
}

/**
 * @brief Send WebRTC message generated by KVS back to the Matter controller.
 *
 * Called from matterSendMessage() (which runs on the KVS peer-connection thread)
 * when KVS produces an answer or ICE candidates. Schedules the actual Matter
 * command dispatch on the Matter event-loop thread.
 *
 * For ANSWER messages:
 *   - Extracts the raw SDP from the JSON payload
 *   - Calls transport->OnLocalDescription(sdp, SDPType::Answer) which triggers:
 *       WebRTCProviderManager::OnLocalDescription -> ScheduleAnswerSend
 *   - The transport must already be in SendingAnswer state (set in HandleProvideOffer)
 *
 * For ICE_CANDIDATE messages:
 *   - Extracts the raw candidate string from the JSON payload
 *   - Appends it to the transport's local candidate list
 *   - Calls ScheduleICECandidatesSend to send the batch to the controller
 */
extern "C" WEBRTC_STATUS matter_signaling_send_message_via_matter(
    void *provider_manager_ptr,
    uint16_t sessionId,
    webrtc_message_t *pMessage)
{
    if (provider_manager_ptr == NULL || pMessage == NULL) {
        ESP_LOGE(TAG, "Invalid arguments: provider_manager=%p, pMessage=%p",
                 provider_manager_ptr, pMessage);
        return WEBRTC_STATUS_NULL_ARG;
    }

    WebRTCProviderManager *provider_manager =
        reinterpret_cast<WebRTCProviderManager *>(provider_manager_ptr);

    switch (pMessage->message_type) {

    case WEBRTC_MESSAGE_TYPE_ANSWER: {
        if (pMessage->payload == NULL || pMessage->payload_len == 0) {
            ESP_LOGE(TAG, "Answer message has no payload");
            return WEBRTC_STATUS_NULL_ARG;
        }

        // Extract raw SDP from KVS JSON: {"type": "answer", "sdp": "..."}
        // Extraction and unescaping must happen here (on the KVS thread) because
        // the payload pointer is only valid until matterSendMessage returns.
        std::string sdp = extract_json_string(pMessage->payload, "sdp");
        if (sdp.empty()) {
            ESP_LOGE(TAG, "Failed to extract SDP from answer JSON payload: %.*s",
                     (int)pMessage->payload_len, pMessage->payload);
            return WEBRTC_STATUS_INVALID_ARG;
        }

        ESP_LOGI(TAG, "Routing KVS answer (SDP len=%zu) to Matter for session %u",
                 sdp.length(), sessionId);

        // Allocate structure to hold SDP data (will be freed in lambda)
        // Lambda must be trivially copyable and <= 24 bytes, so we capture only a pointer.
        size_t sdp_len = sdp.length();
        StringData *sdp_data = new (std::nothrow) StringData;
        if (sdp_data == nullptr) {
            ESP_LOGE(TAG, "Failed to allocate StringData for SDP");
            return WEBRTC_STATUS_NOT_ENOUGH_MEMORY;
        }
        sdp_data->data = new (std::nothrow) char[sdp_len + 1];
        if (sdp_data->data == nullptr) {
            ESP_LOGE(TAG, "Failed to allocate buffer for SDP (len=%zu)", sdp_len);
            delete sdp_data;
            return WEBRTC_STATUS_NOT_ENOUGH_MEMORY;
        }
        memcpy(sdp_data->data, sdp.c_str(), sdp_len + 1);
        sdp_data->len = sdp_len;

        // Schedule delivery on the Matter event-loop thread
        // Capture only: provider_manager (8), sessionId (2->8 with padding), sdp_data* (8) = 24 bytes
        DeviceLayer::SystemLayer().ScheduleLambda([provider_manager, sessionId, sdp_data]() {
            WebrtcTransport *transport = provider_manager->GetTransport(sessionId);
            if (transport == nullptr) {
                ESP_LOGE(TAG, "Transport not found for sessionId %u (answer)", sessionId);
                delete[] sdp_data->data;
                delete sdp_data;
                return;
            }

            // Construct string from buffer (transport will copy it)
            std::string sdp_str(sdp_data->data, sdp_data->len);
            delete[] sdp_data->data;
            delete sdp_data; // Free structure after constructing string

            // Transport is in SendingAnswer state (set by HandleProvideOffer).
            // OnLocalDescription:
            //  1. Sets mLocalSdp (read later by SendAnswerCommand)
            //  2. Fires mOnLocalDescription callback ->
            //     WebRTCProviderManager::OnLocalDescription ->
            //     ScheduleAnswerSend (because state == SendingAnswer)
            transport->OnLocalDescription(sdp_str, SDPType::Answer);
        });
        break;
    }

    case WEBRTC_MESSAGE_TYPE_ICE_CANDIDATE: {
        if (pMessage->payload == NULL || pMessage->payload_len == 0) {
            ESP_LOGE(TAG, "ICE candidate message has no payload");
            return WEBRTC_STATUS_NULL_ARG;
        }

        // Extract raw candidate from KVS JSON: {"candidate": "..."}
        std::string candidate = extract_json_string(pMessage->payload, "candidate");
        if (candidate.empty()) {
            ESP_LOGE(TAG, "Failed to extract candidate from ICE JSON payload: %.*s",
                     (int)pMessage->payload_len, pMessage->payload);
            return WEBRTC_STATUS_INVALID_ARG;
        }

        ESP_LOGI(TAG, "Routing KVS ICE candidate to Matter for session %u", sessionId);

        // Allocate structure to hold candidate data (will be freed in lambda)
        // Lambda must be trivially copyable and <= 24 bytes, so we capture only a pointer.
        size_t candidate_len = candidate.length();
        StringData *candidate_data = new (std::nothrow) StringData;
        if (candidate_data == nullptr) {
            ESP_LOGE(TAG, "Failed to allocate StringData for ICE candidate");
            return WEBRTC_STATUS_NOT_ENOUGH_MEMORY;
        }
        candidate_data->data = new (std::nothrow) char[candidate_len + 1];
        if (candidate_data->data == nullptr) {
            ESP_LOGE(TAG, "Failed to allocate buffer for ICE candidate (len=%zu)", candidate_len);
            delete candidate_data;
            return WEBRTC_STATUS_NOT_ENOUGH_MEMORY;
        }
        memcpy(candidate_data->data, candidate.c_str(), candidate_len + 1);
        candidate_data->len = candidate_len;

        // Schedule delivery on the Matter event-loop thread
        // Capture only: provider_manager (8), sessionId (2->8 with padding), candidate_data* (8) = 24 bytes
        DeviceLayer::SystemLayer().ScheduleLambda([provider_manager, sessionId, candidate_data]() {
            WebrtcTransport *transport = provider_manager->GetTransport(sessionId);
            if (transport == nullptr) {
                ESP_LOGE(TAG, "Transport not found for sessionId %u (ICE)", sessionId);
                delete[] candidate_data->data;
                delete candidate_data;
                return;
            }

            // Construct string from buffer (transport will copy it)
            std::string candidate_str(candidate_data->data, candidate_data->len);
            delete[] candidate_data->data;
            delete candidate_data; // Free structure after constructing string

            // Use the transport's OnICECandidate callback to accumulate candidates,
            // matching the pattern used in the working camera example.
            // The transport will accumulate candidates in mLocalCandidates, and they
            // will be sent via the existing flow (e.g., after answer is sent).
            transport->OnICECandidate(candidate_str);
        });
        break;
    }

    case WEBRTC_MESSAGE_TYPE_OFFER:
        // KVS generates an outbound offer only when we are the initiator (SolicitOffer flow).
        // In the ProvideOffer flow (camera as responder) this should not occur.
        ESP_LOGW(TAG, "Ignoring outbound offer from KVS for session %u "
                 "(camera is responder in ProvideOffer flow)", sessionId);
        break;

    default:
        ESP_LOGW(TAG, "Ignoring unknown outbound message type %d from KVS for session %u",
                 pMessage->message_type, sessionId);
        break;
    }

    return WEBRTC_STATUS_SUCCESS;
}
