## examples/light_wifi_prov/sdkconfig.defaults
```kconfig
CONFIG_ESPTOOLPY_FLASHSIZE_4MB=y

# Compiler options
CONFIG_COMPILER_OPTIMIZATION_SIZE=y

#enable BT
CONFIG_BT_ENABLED=y
CONFIG_BT_NIMBLE_ENABLED=y
CONFIG_BT_NIMBLE_ROLE_CENTRAL=n
CONFIG_BT_NIMBLE_ROLE_OBSERVER=n
CONFIG_BT_NIMBLE_LOG_LEVEL_WARNING=y

# Enable Extended advertisement of NIMBLE
CONFIG_BT_NIMBLE_EXT_ADV=y
CONFIG_BT_NIMBLE_MAX_EXT_ADV_INSTANCES=2

#disable BT connection reattempt
CONFIG_BT_NIMBLE_ENABLE_CONN_REATTEMPT=n

#enable lwip ipv6 autoconfig
CONFIG_LWIP_IPV6_AUTOCONFIG=y

# Use a custom partition table
CONFIG_PARTITION_TABLE_CUSTOM=y
CONFIG_PARTITION_TABLE_FILENAME="partitions.csv"
CONFIG_PARTITION_TABLE_OFFSET=0xC000

# Enable chip shell
CONFIG_ENABLE_CHIP_SHELL=y

#enable lwIP route hooks
CONFIG_LWIP_HOOK_IP6_ROUTE_DEFAULT=y
CONFIG_LWIP_HOOK_ND6_GET_GW_DEFAULT=y

# Button
CONFIG_BUTTON_PERIOD_TIME_MS=20
CONFIG_BUTTON_LONG_PRESS_TIME_MS=5000

# disable softap by default
CONFIG_ESP_WIFI_SOFTAP_SUPPORT=n

# Disable DS Peripheral
CONFIG_ESP_SECURE_CERT_DS_PERIPHERAL=n

# Enable HKDF in mbedtls
CONFIG_MBEDTLS_HKDF_C=y

# Increase LwIP IPv6 address number to 6 (MAX_FABRIC + 1)
# unique local addresses for fabrics(MAX_FABRIC), a link local address(1)
CONFIG_LWIP_IPV6_NUM_ADDRESSES=6

# mbedtls
CONFIG_MBEDTLS_DYNAMIC_BUFFER=y
CONFIG_MBEDTLS_DYNAMIC_FREE_PEER_CERT=y
CONFIG_MBEDTLS_DYNAMIC_FREE_CONFIG_DATA=y
CONFIG_MBEDTLS_CERTIFICATE_BUNDLE_DEFAULT_CMN=y
CONFIG_MBEDTLS_SSL_KEEP_PEER_CERTIFICATE=n
CONFIG_MBEDTLS_ERROR_STRINGS=n

# Fix for Timer Overflows
CONFIG_FREERTOS_TIMER_TASK_STACK_DEPTH=3120

# External Platform
CONFIG_CHIP_ENABLE_EXTERNAL_PLATFORM=y
CONFIG_CHIP_EXTERNAL_PLATFORM_DIR="../../../../examples/common/secondary_ble_adv/platform/ESP32_custom"
CONFIG_CHIP_EXTERNAL_PLATFORM_INCLUDE_DIR="../../../../examples/common/secondary_ble_adv"

# Additional configurations
CONFIG_ESP_RMAKER_USER_ID_CHECK=y
CONFIG_ESP_RMAKER_NO_CLAIM=y
CONFIG_ESP_RMAKER_USE_ESP_SECURE_CERT_MGR=y
CONFIG_ESP_RMAKER_READ_NODE_ID_FROM_CERT_CN=y

CONFIG_CHIP_FACTORY_NAMESPACE_PARTITION_LABEL="fctry"
CONFIG_ENABLE_ESP32_FACTORY_DATA_PROVIDER=y
CONFIG_ENABLE_ESP32_DEVICE_INSTANCE_INFO_PROVIDER=y
CONFIG_ENABLE_ESP32_DEVICE_INFO_PROVIDER=y
CONFIG_SEC_CERT_DAC_PROVIDER=y

# Enable Newlib nano format for flash optimization
CONFIG_NEWLIB_NANO_FORMAT=y
```

## examples/light_wifi_prov/sdkconfig.defaults.esp32c3
```kconfig
CONFIG_IDF_TARGET="esp32c3"

# ESP32-C3-DevKitC-02 Settings
# Buttons
CONFIG_BSP_BUTTONS_NUM=1
CONFIG_BSP_BUTTON_1_TYPE_GPIO=y
CONFIG_BSP_BUTTON_1_GPIO=9
CONFIG_BSP_BUTTON_1_LEVEL=0
# LEDs
CONFIG_BSP_LEDS_NUM=1
CONFIG_BSP_LED_TYPE_RGB=y
CONFIG_BSP_LED_RGB_GPIO=8
CONFIG_BSP_LED_RGB_BACKEND_RMT=y

# Memory Optimization
CONFIG_ESP_WIFI_IRAM_OPT=n
CONFIG_ESP_WIFI_RX_IRAM_OPT=n
CONFIG_ESP_MATTER_MAX_DEVICE_TYPE_COUNT=2
CONFIG_ESP_MATTER_BINDING_TABLE_SIZE=1
CONFIG_EVENT_LOGGING_CRIT_BUFFER_SIZE=512
CONFIG_EVENT_LOGGING_INFO_BUFFER_SIZE=256
CONFIG_EVENT_LOGGING_DEBUG_BUFFER_SIZE=256
CONFIG_MAX_EXCHANGE_CONTEXTS=5
CONFIG_MAX_BINDINGS=2
CONFIG_MAX_PEER_NODES=8
CONFIG_NUM_TCP_ENDPOINTS=1
CONFIG_NUM_UDP_ENDPOINTS=6
```

## examples/light_wifi_prov/sdkconfig.defaults.esp32c3.ext_plat_ci
```kconfig
#enable BT
CONFIG_BT_ENABLED=y
CONFIG_BT_NIMBLE_ENABLED=y

# Enable Extended advertisement of NIMBLE
CONFIG_BT_NIMBLE_EXT_ADV=y
CONFIG_BT_NIMBLE_MAX_EXT_ADV_INSTANCES=2

#disable BT connection reattempt
CONFIG_BT_NIMBLE_ENABLE_CONN_REATTEMPT=n

#enable lwip ipv6 autoconfig
CONFIG_LWIP_IPV6_AUTOCONFIG=y

# Use a custom partition table
CONFIG_PARTITION_TABLE_CUSTOM=y
CONFIG_PARTITION_TABLE_FILENAME="partitions.csv"
CONFIG_PARTITION_TABLE_OFFSET=0xC000

# Enable chip shell
CONFIG_ENABLE_CHIP_SHELL=y

#enable lwIP route hooks
CONFIG_LWIP_HOOK_IP6_ROUTE_DEFAULT=y
CONFIG_LWIP_HOOK_ND6_GET_GW_DEFAULT=y

# Button
CONFIG_BUTTON_PERIOD_TIME_MS=20
CONFIG_BUTTON_LONG_PRESS_TIME_MS=5000

# Enable HKDF in mbedtls
CONFIG_MBEDTLS_HKDF_C=y

# ESP32-S3-DevKitC-1 Settings
# Buttons
CONFIG_BSP_BUTTONS_NUM=1
CONFIG_BSP_BUTTON_1_TYPE_GPIO=y
CONFIG_BSP_BUTTON_1_GPIO=0
CONFIG_BSP_BUTTON_1_LEVEL=0

# mbedtls
CONFIG_MBEDTLS_DYNAMIC_BUFFER=y
CONFIG_MBEDTLS_DYNAMIC_FREE_PEER_CERT=y
CONFIG_MBEDTLS_DYNAMIC_FREE_CONFIG_DATA=y
CONFIG_MBEDTLS_CERTIFICATE_BUNDLE_DEFAULT_CMN=y

# For additional security on reset to factory
CONFIG_ESP_RMAKER_USER_ID_CHECK=y

# Fix for Timer Overflows
CONFIG_FREERTOS_TIMER_TASK_STACK_DEPTH=3120

# External Platform
CONFIG_CHIP_ENABLE_EXTERNAL_PLATFORM=y
CONFIG_CHIP_EXTERNAL_PLATFORM_DIR="../../../../../builds/app-frameworks/esp-matter/examples/common/secondary_ble_adv/platform/ESP32_custom"
CONFIG_CHIP_EXTERNAL_PLATFORM_INCLUDE_DIR="../../../../../builds/app-frameworks/esp-matter/examples/common/secondary_ble_adv"

# Memory Optimization
CONFIG_ESP_WIFI_IRAM_OPT=n
CONFIG_ESP_WIFI_RX_IRAM_OPT=n
CONFIG_ESP_MATTER_MAX_DEVICE_TYPE_COUNT=2
CONFIG_ESP_MATTER_BINDING_TABLE_SIZE=1
CONFIG_EVENT_LOGGING_CRIT_BUFFER_SIZE=512
CONFIG_EVENT_LOGGING_INFO_BUFFER_SIZE=256
CONFIG_EVENT_LOGGING_DEBUG_BUFFER_SIZE=256
CONFIG_MAX_EXCHANGE_CONTEXTS=5
CONFIG_MAX_BINDINGS=2
CONFIG_MAX_PEER_NODES=8
CONFIG_NUM_TCP_ENDPOINTS=1
CONFIG_NUM_UDP_ENDPOINTS=6
```

## examples/managed_component_light/sdkconfig.defaults.esp32s2
```kconfig
CONFIG_IDF_TARGET="esp32s2"

# Disable BLE
CONFIG_ENABLE_CHIPOBLE=n

# ESP32-S2-DevKitM-1 Settings
# Buttons
CONFIG_BSP_BUTTONS_NUM=1
CONFIG_BSP_BUTTON_1_TYPE_GPIO=y
CONFIG_BSP_BUTTON_1_GPIO=0
CONFIG_BSP_BUTTON_1_LEVEL=0
# LEDs
CONFIG_BSP_LEDS_NUM=1
CONFIG_BSP_LED_TYPE_RGB=y
CONFIG_BSP_LED_RGB_GPIO=18
CONFIG_BSP_LED_RGB_BACKEND_RMT=y
```

## examples/managed_component_light/sdkconfig.defaults.esp32s3
```kconfig
CONFIG_IDF_TARGET="esp32s3"

# Use compact attribute storage mode
CONFIG_ESP_MATTER_NVS_USE_COMPACT_ATTR_STORAGE=y

# ESP32-S3-DevKitC-1 Settings
# Buttons
CONFIG_BSP_BUTTONS_NUM=1
CONFIG_BSP_BUTTON_1_TYPE_GPIO=y
CONFIG_BSP_BUTTON_1_GPIO=0
CONFIG_BSP_BUTTON_1_LEVEL=0
# LEDs
CONFIG_BSP_LEDS_NUM=1
CONFIG_BSP_LED_TYPE_RGB=y
CONFIG_BSP_LED_RGB_GPIO=48
CONFIG_BSP_LED_RGB_BACKEND_RMT=y
```

## examples/mfg_test_app/sdkconfig.defaults
```kconfig
#enable lwip ipv6 autoconfig
CONFIG_LWIP_IPV6_AUTOCONFIG=y

# Use a custom partition table
CONFIG_PARTITION_TABLE_CUSTOM=y
CONFIG_PARTITION_TABLE_FILENAME="partitions.csv"
CONFIG_PARTITION_TABLE_OFFSET=0xC000

#enable lwIP route hooks
CONFIG_LWIP_HOOK_IP6_ROUTE_DEFAULT=y
CONFIG_LWIP_HOOK_ND6_GET_GW_DEFAULT=y

# Disable DS Peripheral
CONFIG_ESP_SECURE_CERT_DS_PERIPHERAL=n

# Read attestation data from secure cert partition 
CONFIG_SEC_CERT_DAC_PROVIDER=y

# Enable flash encryption and secure boot in release mode
CONFIG_SECURE_BOOT=y
CONFIG_SECURE_BOOT_SIGNING_KEY="secure_boot_signing_key.pem"
CONFIG_SECURE_FLASH_ENC_ENABLED=y
CONFIG_SECURE_FLASH_ENCRYPTION_MODE_RELEASE=y

CONFIG_DEVICE_VENDOR_ID=0x131B

# Disable STA and AP
CONFIG_ENABLE_WIFI_STATION=n
CONFIG_ENABLE_WIFI_AP=n
```

## examples/mfg_test_app/sdkconfig.defaults.esp32h2
```kconfig
CONFIG_IDF_TARGET="esp32h2"

# These are required in order to build otherwise, build fails for esp_coex component
CONFIG_BT_ENABLED=y
CONFIG_OPENTHREAD_ENABLED=y
CONFIG_BT_NIMBLE_ENABLED=y

# Enable DS Peripheral
CONFIG_ESP_SECURE_CERT_DS_PERIPHERAL=y

# Disable STA and AP for ESP32H2
CONFIG_ENABLE_WIFI_STATION=n
CONFIG_ENABLE_WIFI_AP=n
```

## examples/multiple_on_off_plugin_units/main/Kconfig.projbuild
```kconfig
menu "Plugin manager"
    config USER_BUTTON
        bool "Use custom GPIO for factory reset button"
        default n

    config USER_BUTTON_GPIO
        int "GPIO pin number for factory reset button"
        default 0 if IDF_TARGET_ESP32 || IDF_TARGET_ESP32S3
        default 9
        depends on USER_BUTTON

    config USER_BUTTON_LEVEL
        int "GPIO level when factory reset button is active"
        default 0
        range 0 1
        depends on USER_BUTTON
    
    config NUM_VIRTUAL_PLUGS
        int "Number of virtual plugs"
        default 3
        range 1 11 if IDF_TARGET_ESP32C2
        range 1 12 if IDF_TARGET_ESP32C3
        range 1 16

    config GPIO_PLUG_1
        int "GPIO pin number for plug 1"
        default 2
        depends on (NUM_VIRTUAL_PLUGS >= 1)
        help
            Set GPIO pin value for target chip to create plugin unit

    config GPIO_PLUG_2
        int "GPIO pin number for plug 2"
        default 4
        depends on (NUM_VIRTUAL_PLUGS >= 2)
        help
            Set GPIO pin value for target chip to create plugin unit
    
    config GPIO_PLUG_3
        int "GPIO pin number for plug 3"
        default 5
        depends on (NUM_VIRTUAL_PLUGS >= 3)
        help
            Set GPIO pin value for target chip to create plugin unit
    
    config GPIO_PLUG_4
        int "GPIO pin number for plug 4"
        default 6 if IDF_TARGET_ESP32C2 || IDF_TARGET_ESP32C3
        default 12
        depends on (NUM_VIRTUAL_PLUGS >= 4)
        help
            Set GPIO pin value for target chip to create plugin unit
    
    config GPIO_PLUG_5
        int "GPIO pin number for plug 5"
        default 7 if IDF_TARGET_ESP32C2 || IDF_TARGET_ESP32C3
        default 13
        depends on (NUM_VIRTUAL_PLUGS >= 5)
        help
            Set GPIO pin value for target chip to create plugin unit
    
    config GPIO_PLUG_6
        int "GPIO pin number for plug 6"
        default 8 if IDF_TARGET_ESP32C2 || IDF_TARGET_ESP32C3
        default 15 if IDF_TARGET_ESP32C6
        default 14
        depends on (NUM_VIRTUAL_PLUGS >= 6)
        help
            Set GPIO pin value for target chip to create plugin unit
    
    config GPIO_PLUG_7
        int "GPIO pin number for plug 7"
        default 10 if IDF_TARGET_ESP32C2 || IDF_TARGET_ESP32C3
        default 18 if IDF_TARGET_ESP32C6
        default 22 if IDF_TARGET_ESP32H2
        default 15
        depends on (NUM_VIRTUAL_PLUGS >= 7)
        help
            Set GPIO pin value for target chip to create plugin unit
    
    config GPIO_PLUG_8
        int "GPIO pin number for plug 8"
        default 18 if IDF_TARGET_ESP32C2 || IDF_TARGET_ESP32C3
        default 19 if IDF_TARGET_ESP32C6
        default 25 if IDF_TARGET_ESP32H2
        default 16
        depends on (NUM_VIRTUAL_PLUGS >= 8)
        help
            Set GPIO pin value for target chip to create plugin unit
    
    config GPIO_PLUG_9
        int "GPIO pin number for plug 9"
        default 0 if IDF_TARGET_ESP32C2
        default 19 if IDF_TARGET_ESP32C3
        default 20 if IDF_TARGET_ESP32C6
        default 26 if IDF_TARGET_ESP32H2
        default 17
        depends on (NUM_VIRTUAL_PLUGS >= 9)
        help
            Set GPIO pin value for target chip to create plugin unit
    
    config GPIO_PLUG_10
        int "GPIO pin number for plug 10"
        default 1 if IDF_TARGET_ESP32C2
        default 0 if IDF_TARGET_ESP32C3
        default 21 if IDF_TARGET_ESP32C6
        default 27 if IDF_TARGET_ESP32H2
        default 18
        depends on (NUM_VIRTUAL_PLUGS >= 10)
        help
            Set GPIO pin value for target chip to create plugin unit
    
    config GPIO_PLUG_11
        int "GPIO pin number for plug 11"
        default 3 if IDF_TARGET_ESP32C2
        default 1 if IDF_TARGET_ESP32C3
        default 22 if IDF_TARGET_ESP32C6
        default 0 if IDF_TARGET_ESP32H2
        default 19
        depends on (NUM_VIRTUAL_PLUGS >= 11)
        help
            Set GPIO pin value for target chip to create plugin unit
    
    config GPIO_PLUG_12
        int "GPIO pin number for plug 12"
        default 3 if IDF_TARGET_ESP32C3
        default 23 if IDF_TARGET_ESP32C6
        default 1 if IDF_TARGET_ESP32H2
        default 20 if IDF_TARGET_ESP32S3
        default 21
        depends on (NUM_VIRTUAL_PLUGS >= 12)
        help
            Set GPIO pin value for target chip to create plugin unit
    
    config GPIO_PLUG_13
        int "GPIO pin number for plug 13"
        default 0 if IDF_TARGET_ESP32C6
        default 3 if IDF_TARGET_ESP32H2
        default 21 if IDF_TARGET_ESP32S3
        default 22
        depends on (NUM_VIRTUAL_PLUGS >= 13)
        help
            Set GPIO pin value for target chip to create plugin unit
    
    config GPIO_PLUG_14
        int "GPIO pin number for plug 14"
        default 1 if IDF_TARGET_ESP32C6
        default 8 if IDF_TARGET_ESP32H2
        default 35 if IDF_TARGET_ESP32S3
        default 23
        depends on (NUM_VIRTUAL_PLUGS >= 14)
        help
            Set GPIO pin value for target chip to create plugin unit
    
    config GPIO_PLUG_15
        int "GPIO pin number for plug 15"
        default 3 if IDF_TARGET_ESP32C6
        default 10 if IDF_TARGET_ESP32H2
        default 36 if IDF_TARGET_ESP32S3
        default 25
        depends on (NUM_VIRTUAL_PLUGS >= 15)
        help
            Set GPIO pin value for target chip to create plugin unit
    
    config GPIO_PLUG_16
        int "GPIO pin number for plug 16"
        default 6 if IDF_TARGET_ESP32C6
        default 11 if IDF_TARGET_ESP32H2
        default 37 if IDF_TARGET_ESP32S3
        default 26
        depends on (NUM_VIRTUAL_PLUGS >= 16)
        help
            Set GPIO pin value for target chip to create plugin unit
endmenu
```
