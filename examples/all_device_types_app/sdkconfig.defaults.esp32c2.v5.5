## examples/all_device_types_app/sdkconfig.defaults.esp32c2.v5.5
```kconfig
# Compiler options
CONFIG_COMPILER_OPTIMIZATION_SIZE=y
CONFIG_COMPILER_SAVE_RESTORE_LIBCALLS=y
CONFIG_COMPILER_OPTIMIZATION_ASSERTIONS_DISABLE=y

# Main XTAL Config
CONFIG_XTAL_FREQ_26=y
CONFIG_XTAL_FREQ=26

# Chip revision
CONFIG_ESP32C2_REV_MIN_200=y # minimum support ECO4+

# NimBLE Options
CONFIG_BT_NIMBLE_MAX_CONNECTIONS=1
CONFIG_BT_NIMBLE_MAX_BONDS=2
CONFIG_BT_NIMBLE_MAX_CCCDS=2
CONFIG_BT_NIMBLE_HOST_TASK_STACK_SIZE=3072
CONFIG_BT_NIMBLE_ROLE_CENTRAL=y
CONFIG_BT_NIMBLE_ROLE_OBSERVER=n
CONFIG_BT_NIMBLE_SECURITY_ENABLE=n
CONFIG_BT_NIMBLE_50_FEATURE_SUPPORT=n
CONFIG_BT_NIMBLE_WHITELIST_SIZE=1
CONFIG_BT_NIMBLE_GATT_MAX_PROCS=1
CONFIG_BT_NIMBLE_MSYS_1_BLOCK_COUNT=10
CONFIG_BT_NIMBLE_MSYS_1_BLOCK_SIZE=100
CONFIG_BT_NIMBLE_MSYS_2_BLOCK_COUNT=4
CONFIG_BT_NIMBLE_MSYS_2_BLOCK_SIZE=320
CONFIG_BT_NIMBLE_TRANSPORT_ACL_FROM_LL_COUNT=5
CONFIG_BT_NIMBLE_TRANSPORT_ACL_SIZE=255
CONFIG_BT_NIMBLE_TRANSPORT_EVT_SIZE=70
CONFIG_BT_NIMBLE_TRANSPORT_EVT_COUNT=5
CONFIG_BT_NIMBLE_TRANSPORT_EVT_DISCARD_COUNT=3

# Controller Options
CONFIG_BT_LE_CONTROLLER_TASK_STACK_SIZE=3072
CONFIG_BT_LE_LL_RESOLV_LIST_SIZE=1
CONFIG_BT_LE_LL_DUP_SCAN_LIST_COUNT=1
CONFIG_BT_CTRL_RUN_IN_FLASH_ONLY=y

# Bluetooth
CONFIG_BT_RELEASE_IRAM=y

# SPI Configuration
CONFIG_SPI_MASTER_ISR_IN_IRAM=n
CONFIG_SPI_SLAVE_ISR_IN_IRAM=n

# Peripheral Control
CONFIG_PERIPH_CTRL_FUNC_IN_IRAM=n

# ESP-Driver:GPTimer Configurations
CONFIG_GPTIMER_ISR_HANDLER_IN_IRAM=n
GPTIMER_ISR_CACHE_SAFE=n
CONFIG_GPTIMER_OBJ_CACHE_SAFE=n

# Common ESP-related
CONFIG_ESP_SYSTEM_EVENT_QUEUE_SIZE=16
CONFIG_ESP_SYSTEM_EVENT_TASK_STACK_SIZE=2048
CONFIG_ESP_MAIN_TASK_STACK_SIZE=3072

# Memory protection
CONFIG_ESP_SYSTEM_PMP_IDRAM_SPLIT=n

# FreeRTOS
CONFIG_FREERTOS_TIMER_TASK_STACK_DEPTH=2048
CONFIG_FREERTOS_PLACE_FUNCTIONS_INTO_FLASH=y
CONFIG_FREERTOS_PLACE_SNAPSHOT_FUNS_INTO_FLASH=y
CONFIG_FREERTOS_PLACE_ISR_FUNCTIONS_INTO_FLASH=y

# Wi-Fi
CONFIG_ESP_WIFI_STATIC_RX_BUFFER_NUM=3
CONFIG_ESP_WIFI_DYNAMIC_RX_BUFFER_NUM=6
CONFIG_ESP_WIFI_DYNAMIC_TX_BUFFER_NUM=16
CONFIG_ESP_WIFI_SLP_IRAM_OPT=n

# General Options
CONFIG_MAX_EXCHANGE_CONTEXTS=6
CONFIG_MAX_BINDINGS=6
CONFIG_MAX_PEER_NODES=12
CONFIG_MAX_UNSOLICITED_MESSAGE_HANDLERS=6


# Networking Options
CONFIG_NUM_TCP_ENDPOINTS=1
CONFIG_NUM_UDP_ENDPOINTS=6

# System Options
CONFIG_NUM_TIMERS=24

# Event Logging Options
CONFIG_EVENT_LOGGING_CRIT_BUFFER_SIZE=256
CONFIG_EVENT_LOGGING_INFO_BUFFER_SIZE=256
CONFIG_EVENT_LOGGING_DEBUG_BUFFER_SIZE=256

# Matter One RainMaker
CONFIG_MATTER_ONE_DISABLE_RAINMAKER=y

# Event Loop Library
CONFIG_ESP_EVENT_POST_FROM_ISR=n

# Chip endpoint
CONFIG_ESP_MATTER_MAX_DYNAMIC_ENDPOINT_COUNT=5

# Chip event queue size
CONFIG_MAX_EVENT_QUEUE_SIZE=25

# Heap memory debugging
CONFIG_HEAP_PLACE_FUNCTION_INTO_FLASH=y

# Log
CONFIG_LOG_MAXIMUM_LEVEL_INFO=y
CONFIG_LOG_IN_IRAM=n

# ESP-Driver:SPI Configurations
CONFIG_SPI_SLAVE_IN_IRAM=n
CONFIG_SPI_SLAVE_ISR_IN_IRAM=n

# LibC
CONFIG_LIBC_MISC_IN_IRAM=n
CONFIG_LIBC_LOCKS_PLACE_IN_IRAM=n
CONFIG_LIBC_NEWLIB_NANO_FORMAT=y
CONFIG_NEWLIB_NANO_FORMAT=y

# Hardware Abstraction Layer (HAL) and Low Level (LL)
CONFIG_HAL_ASSERTION_DISABLE=y
CONFIG_HAL_DEFAULT_ASSERTION_LEVEL=0

# SPI Flash driver
CONFIG_SPI_FLASH_AUTO_SUSPEND=y
CONFIG_SPI_FLASH_PLACE_FUNCTIONS_IN_IRAM=n
CONFIG_SPI_FLASH_AUTO_CHECK_SUSPEND_STATUS=y
CONFIG_SPI_FLASH_ROM_IMPL=n

# ESP Timer (High Resolution Timer)
CONFIG_ESP_TIMER_IN_IRAM=n

# Hardware Settings
CONFIG_ESP_INTR_IN_IRAM=n

# ESP-ROM
CONFIG_ESP_ROM_PRINT_IN_IRAM=n

# ESP System Settings
CONFIG_ESP_SYSTEM_IN_IRAM=n
CONFIG_ESP_PANIC_HANDLER_IRAM=n

# Power Management
CONFIG_PM_SLEEP_FUNC_IN_IRAM=n
CONFIG_PM_SLP_IRAM_OPT=n
CONFIG_PM_RTOS_IDLE_OPT=n

# Sleep Config
CONFIG_ESP_SLEEP_POWER_DOWN_FLASH=n

# Peripheral Control
CONFIG_ESP_PERIPH_CTRL_FUNC_IN_IRAM=n
CONFIG_ESP_REGI2C_CTRL_FUNC_IN_IRAM=n

# PHY
CONFIG_ESP_PHY_IRAM_OPT=n
```

## examples/all_device_types_app/sdkconfig.defaults.esp32h2
```kconfig
CONFIG_IDF_TARGET="esp32h2"

# libsodium
CONFIG_LIBSODIUM_USE_MBEDTLS_SHA=y

# NIMBLE
CONFIG_BT_ENABLED=y
CONFIG_BT_NIMBLE_ENABLED=y
CONFIG_BT_NIMBLE_EXT_ADV=n
CONFIG_BT_NIMBLE_HCI_EVT_BUF_SIZE=70
CONFIG_USE_BLE_ONLY_FOR_COMMISSIONING=n

# FreeRTOS should use legacy API
CONFIG_FREERTOS_ENABLE_BACKWARD_COMPATIBILITY=y

# Enable OpenThread
CONFIG_OPENTHREAD_ENABLED=y
CONFIG_OPENTHREAD_SRP_CLIENT=y
CONFIG_OPENTHREAD_DNS_CLIENT=y
CONFIG_OPENTHREAD_LOG_LEVEL_DYNAMIC=n
CONFIG_OPENTHREAD_LOG_LEVEL_NOTE=y
CONFIG_OPENTHREAD_CLI=n


# Disable lwip ipv6 autoconfig
CONFIG_LWIP_IPV6_AUTOCONFIG=n

# Use a custom partition table
CONFIG_PARTITION_TABLE_CUSTOM=y
CONFIG_PARTITION_TABLE_CUSTOM_FILENAME="partitions_thread.csv"

# LwIP config for OpenThread
CONFIG_LWIP_IPV6_NUM_ADDRESSES=8
CONFIG_LWIP_MULTICAST_PING=y

# MDNS platform
CONFIG_USE_MINIMAL_MDNS=n
CONFIG_ENABLE_EXTENDED_DISCOVERY=y

# Enable OTA Requestor
CONFIG_ENABLE_OTA_REQUESTOR=y

# Disable STA and AP for ESP32H2
CONFIG_ENABLE_WIFI_STATION=n
CONFIG_ENABLE_WIFI_AP=n

# Button
CONFIG_BUTTON_PERIOD_TIME_MS=20
CONFIG_BUTTON_LONG_PRESS_TIME_MS=5000

# Enable chip shell
CONFIG_ENABLE_CHIP_SHELL=y

# Enable DS Peripheral
CONFIG_ESP_SECURE_CERT_DS_PERIPHERAL=y
```

## examples/all_device_types_app/sdkconfig.defaults.esp32s3
```kconfig
CONFIG_IDF_TARGET="esp32s3"

# use for otbr option
CONFIG_LWIP_IPV6_NUM_ADDRESSES=8
```

## examples/all_device_types_app/sdkconfig.defaults.otbr
```kconfig
# Default to 115200 baud when monitoring device
CONFIG_ESPTOOLPY_MONITOR_BAUD=115200
CONFIG_ESPTOOLPY_FLASHSIZE_4MB=y

CONFIG_PARTITION_TABLE_CUSTOM=y
CONFIG_PARTITION_TABLE_CUSTOM_FILENAME="partitions_thread.csv"

# Enable Openthread Border Router, but don't run matter over Thread
CONFIG_OPENTHREAD_ENABLED=y
CONFIG_OPENTHREAD_LOG_LEVEL_DYNAMIC=n
CONFIG_OPENTHREAD_LOG_LEVEL_WARN=y
CONFIG_OPENTHREAD_BORDER_ROUTER=y
CONFIG_OPENTHREAD_SRP_CLIENT=n
CONFIG_OPENTHREAD_DNS_CLIENT=n
CONFIG_THREAD_NETWORK_COMMISSIONING_DRIVER=n

#enable BT
CONFIG_BT_ENABLED=y
CONFIG_BT_NIMBLE_ENABLED=y

#LwIP config for OpenThread
CONFIG_LWIP_IPV6_AUTOCONFIG=y
CONFIG_LWIP_IPV6_NUM_ADDRESSES=8
CONFIG_LWIP_MULTICAST_PING=y
CONFIG_LWIP_IPV6_FORWARD=y
CONFIG_LWIP_HOOK_IP6_ROUTE_DEFAULT=y
CONFIG_LWIP_HOOK_ND6_GET_GW_DEFAULT=y
CONFIG_LWIP_NETIF_STATUS_CALLBACK=y

# mbedTLS
CONFIG_MBEDTLS_HARDWARE_AES=y
CONFIG_MBEDTLS_HARDWARE_MPI=y
CONFIG_MBEDTLS_HARDWARE_SHA=y
CONFIG_MBEDTLS_CMAC_C=y
CONFIG_MBEDTLS_KEY_EXCHANGE_ECJPAKE=y
CONFIG_MBEDTLS_ECJPAKE_C=y
CONFIG_MBEDTLS_SSL_PROTO_DTLS=y
CONFIG_MBEDTLS_HKDF_C=y

# MDNS platform
CONFIG_USE_MINIMAL_MDNS=n
CONFIG_ENABLE_EXTENDED_DISCOVERY=y
CONFIG_MDNS_MULTIPLE_INSTANCE=y

# Enable chip shell
CONFIG_ENABLE_CHIP_SHELL=y
CONFIG_ESP_MATTER_CONSOLE_TASK_STACK=4096
CONFIG_CHIP_SHELL_CMD_LINE_BUF_MAX_LENGTH=512

# Increase Stack size
CONFIG_CHIP_TASK_STACK_SIZE=15360
CONFIG_ESP_MAIN_TASK_STACK_SIZE=8192

# Wi-Fi Settings
CONFIG_ENABLE_WIFI_STATION=y
CONFIG_ENABLE_WIFI_AP=n

# Disable chip test build
CONFIG_BUILD_CHIP_TESTS=n

# Use compact attribute storage mode
CONFIG_ESP_MATTER_NVS_USE_COMPACT_ATTR_STORAGE=y

# Disable route hook for matter since OTBR has already initialize the route hook
CONFIG_ENABLE_ROUTE_HOOK=n

# Use USB Jtag Console
CONFIG_ESP_CONSOLE_USB_SERIAL_JTAG=y

# SPIRAM
CONFIG_SPIRAM=y
CONFIG_SPIRAM_SPEED_80M=y
CONFIG_SPIRAM_MALLOC_ALWAYSINTERNAL=512
CONFIG_SPIRAM_MALLOC_RESERVE_INTERNAL=8192
CONFIG_SPIRAM_ALLOW_BSS_SEG_EXTERNAL_MEMORY=y
CONFIG_SPIRAM_TRY_ALLOCATE_WIFI_LWIP=y

# Disable OTA Requestor
CONFIG_ENABLE_OTA_REQUESTOR=n

CONFIG_ESP_SECURE_CERT_DS_PERIPHERAL=y

# Flash optimization
CONFIG_COMPILER_OPTIMIZATION_SIZE=y
CONFIG_NEWLIB_NANO_FORMAT=y
```

## examples/blemesh_bridge/sdkconfig.defaults.ext_plat_ci
```kconfig
# Default to 921600 baud when flashing and monitoring device
CONFIG_ESPTOOLPY_BAUD_921600B=y
CONFIG_ESPTOOLPY_BAUD=921600
CONFIG_ESPTOOLPY_COMPRESSED=y
CONFIG_ESPTOOLPY_MONITOR_BAUD_115200B=y
CONFIG_ESPTOOLPY_MONITOR_BAUD=115200
CONFIG_ESPTOOLPY_FLASHSIZE_4MB=y

# Enable BT
CONFIG_BT_ENABLED=y
CONFIG_BT_NIMBLE_ENABLED=y
CONFIG_BT_NIMBLE_TASK_STACK_SIZE=5120
CONFIG_BTDM_SCAN_DUPL_TYPE_DATA_DEVICE=y
CONFIG_BTDM_BLE_MESH_SCAN_DUPL_EN=y

# Enable BLE MESH
CONFIG_BLE_MESH=y
CONFIG_BLE_MESH_PROVISIONER=y
CONFIG_BLE_MESH_PB_GATT=y
CONFIG_BLE_MESH_SETTINGS=y
CONFIG_BLE_MESH_CFG_CLI=y
CONFIG_BLE_MESH_GENERIC_ONOFF_CLI=y
CONFIG_BLE_MESH_SUPPORT_BLE_ADV=y

# Enable lwip ipv6 autoconfig
CONFIG_LWIP_IPV6_AUTOCONFIG=y

# Use a custom partition table
CONFIG_PARTITION_TABLE_CUSTOM=y
CONFIG_PARTITION_TABLE_CUSTOM_FILENAME="partitions.csv"

# Disable chip shell and test
CONFIG_ENABLE_CHIP_SHELL=n
CONFIG_BUILD_CHIP_TESTS=n

# BLE still used in BLE MESH
CONFIG_USE_BLE_ONLY_FOR_COMMISSIONING=n

# Enable External Platform
CONFIG_CHIP_ENABLE_EXTERNAL_PLATFORM=y
CONFIG_CHIP_EXTERNAL_PLATFORM_DIR="../../../../../builds/app-frameworks/esp-matter/examples/common/blemesh_platform/platform/ESP32_custom"
CONFIG_CHIP_EXTERNAL_PLATFORM_INCLUDE_DIR="../../../../../builds/app-frameworks/esp-matter/examples/common/blemesh_platform"

# Enable lwIP route hooks
CONFIG_LWIP_HOOK_IP6_ROUTE_DEFAULT=y
CONFIG_LWIP_HOOK_ND6_GET_GW_DEFAULT=y

# Watchdog
CONFIG_ESP_TASK_WDT_CHECK_IDLE_TASK_CPU0=n
CONFIG_ESP_TASK_WDT_CHECK_IDLE_TASK_CPU1=n

# disable softap by default
CONFIG_ESP_WIFI_SOFTAP_SUPPORT=n

# Disable DS Peripheral
CONFIG_ESP_SECURE_CERT_DS_PERIPHERAL=n

# Use compact attribute storage mode
CONFIG_ESP_MATTER_NVS_USE_COMPACT_ATTR_STORAGE=y

# Enable HKDF in mbedtls
CONFIG_MBEDTLS_HKDF_C=y

# Increase LwIP IPv6 address number to 6 (MAX_FABRIC + 1)
# unique local addresses for fabrics(MAX_FABRIC), a link local address(1)
CONFIG_LWIP_IPV6_NUM_ADDRESSES=6
```

## examples/bridge_apps/esp-now_bridge_light/main/Kconfig.projbuild
```kconfig
menu "ESP-NOW Bridge Application Configuration"

    config ESP_IDF_VERSION
        string
        default "$ESP_IDF_VERSION"
    if ESP_IDF_VERSION>="5.0"
        config ESPNOW_BRIDGE_APP_PS_ENABLE
            bool "ESP-NOW power saving"
            default y
            help
                Enable to use ESP-NOW power saving feature. Note that ESP-NOW power saving in STA connected state is
                available only for IDF version >= 5.0.
    endif

    config ESPNOW_BRIDGE_APP_WAKE_INTERVAL
        int "Wake interval for connectionless modules to wake up periodically. (ms)"
        depends on ESPNOW_BRIDGE_APP_PS_ENABLE
        range 1 65535
        default 200
        help
            Set the interval for connectionless module periodic wakeup. Recommend to configure interval in multiples of
            hundred. (e.g. 100ms).

    config ESPNOW_BRIDGE_APP_WAKE_WINDOW
        int "Wake window for esp_now to stay awake in wake interval. (ms)"
        depends on ESPNOW_BRIDGE_APP_PS_ENABLE
        range 0 65535
        default 110
        help
            Set wake window for esp_now to wake up in interval unit.
 
endmenu
```

## examples/bridge_apps/esp-now_bridge_light/sdkconfig.defaults
```kconfig
CONFIG_ESPTOOLPY_FLASHSIZE_4MB=y

#enable BT
CONFIG_BT_ENABLED=y
CONFIG_BT_NIMBLE_ENABLED=y

#enable lwip ipv6 autoconfig
CONFIG_LWIP_IPV6_AUTOCONFIG=y

# Use a custom partition table
CONFIG_PARTITION_TABLE_CUSTOM=y
CONFIG_PARTITION_TABLE_FILENAME="partitions.csv"
CONFIG_PARTITION_TABLE_OFFSET=0xC000

# Enable chip shell
CONFIG_ENABLE_CHIP_SHELL=y

#enable lwIP route hooks
CONFIG_LWIP_HOOK_IP6_ROUTE_DEFAULT=y
CONFIG_LWIP_HOOK_ND6_GET_GW_DEFAULT=y

# Button
CONFIG_BUTTON_PERIOD_TIME_MS=20
CONFIG_BUTTON_LONG_PRESS_TIME_MS=5000

# disable softap by default
CONFIG_ESP_WIFI_SOFTAP_SUPPORT=n

# ESP-NOW Control Configuration
CONFIG_ESPNOW_CONTROL_AUTO_CHANNEL_SENDING=y
CONFIG_ESPNOW_CONTROL_RETRANSMISSION_TIMES=5
CONFIG_ESPNOW_CONTROL_FORWARD_TTL=10
CONFIG_ESPNOW_CONTROL_FORWARD_RSSI=-55

# Enable HKDF in mbedtls
CONFIG_MBEDTLS_HKDF_C=y

# Increase LwIP IPv6 address number to 6 (MAX_FABRIC + 1)
# unique local addresses for fabrics(MAX_FABRIC), a link local address(1)
CONFIG_LWIP_IPV6_NUM_ADDRESSES=6
```

## examples/bridge_apps/esp_rainmaker_bridge/main/Kconfig
```kconfig
menu "Thread BR Example"
    depends on OPENTHREAD_BORDER_ROUTER

    choice THREAD_BR_BOARD_TYPE
        prompt "Thread border router board type"
        default ESP_THREAD_BR_BOARD_DEV_KIT
        help
            The board running the border router.

        config ESP_THREAD_BR_BOARD_DEV_KIT
            bool "ESP Thread border router dev kit"
            help
                Integrated border router dev kit

        config M5STACK_THREAD_BR_BOARD
            bool "M5Stack Thread border router board"
            help
                M5Stack CoreS3 with Module Gateway H2
    endchoice

    menu "Board Configuration"
        config PIN_TO_RCP_RESET
            int "Pin to RCP reset"
            default "7"

        config PIN_TO_RCP_BOOT
            int "Pin to RCP boot"
            default "18" if M5STACK_THREAD_BR_BOARD
            default "8"

        config PIN_TO_RCP_TX
            int "Pin to RCP TX"
            default "10" if M5STACK_THREAD_BR_BOARD
            default "17"

        config PIN_TO_RCP_RX
            int "Pin to RCP RX"
            default "17" if M5STACK_THREAD_BR_BOARD
            default "18"
    endmenu

endmenu
```

## examples/bridge_apps/esp_rainmaker_bridge/sdkconfig.defaults
```kconfig
CONFIG_ESPTOOLPY_FLASHSIZE_8MB=y

# Enable BT
CONFIG_BT_ENABLED=y
CONFIG_BT_NIMBLE_ENABLED=y
CONFIG_BT_NIMBLE_TASK_STACK_SIZE=5120
CONFIG_BT_NIMBLE_ACL_BUF_SIZE=255

# Enable FreeRTOS legacy API
CONFIG_FREERTOS_ENABLE_BACKWARD_COMPATIBILITY=y

# Enable lwip ipv6 autoconfig
CONFIG_LWIP_IPV6_AUTOCONFIG=y

# Use a custom partition table
CONFIG_PARTITION_TABLE_CUSTOM=y
CONFIG_PARTITION_TABLE_CUSTOM_FILENAME="partitions.csv"

# Enable chip shell
CONFIG_ENABLE_CHIP_SHELL=y

# Enable lwIP route hooks
CONFIG_LWIP_HOOK_IP6_ROUTE_DEFAULT=y
CONFIG_LWIP_HOOK_ND6_GET_GW_DEFAULT=y

# Watchdog
CONFIG_ESP_TASK_WDT_CHECK_IDLE_TASK_CPU0=n
CONFIG_ESP_TASK_WDT_CHECK_IDLE_TASK_CPU1=n

# Enable HKDF in mbedtls
CONFIG_MBEDTLS_HKDF_C=y

# Increase LwIP IPv6 address number to 6 (MAX_FABRIC + 1)
# unique local addresses for fabrics(MAX_FABRIC), a link local address(1)
CONFIG_LWIP_IPV6_NUM_ADDRESSES=6

# Increase matter console stack size
CONFIG_ESP_MATTER_CONSOLE_TASK_STACK=3072

# mbedtls
CONFIG_MBEDTLS_DYNAMIC_BUFFER=y
CONFIG_MBEDTLS_DYNAMIC_FREE_PEER_CERT=y
CONFIG_MBEDTLS_DYNAMIC_FREE_CONFIG_DATA=y
CONFIG_MBEDTLS_CERTIFICATE_BUNDLE_DEFAULT_CMN=y

# Disable BLE for matter
CONFIG_ENABLE_CHIPOBLE=n

# Use SPIRAM and external alloc
CONFIG_SPIRAM=y
CONFIG_SPIRAM_SPEED_80M=y
CONFIG_SPIRAM_MODE_QUAD=y
CONFIG_SPIRAM_MALLOC_ALWAYSINTERNAL=512
CONFIG_SPIRAM_MALLOC_RESERVE_INTERNAL=16384
CONFIG_SPIRAM_ALLOW_BSS_SEG_EXTERNAL_MEMORY=y
CONFIG_SPIRAM_TRY_ALLOCATE_WIFI_LWIP=y
CONFIG_BT_NIMBLE_MEM_ALLOC_MODE_EXTERNAL=y
CONFIG_ESP_MATTER_MEM_ALLOC_MODE_EXTERNAL=y
CONFIG_MBEDTLS_EXTERNAL_MEM_ALLOC=y
```
