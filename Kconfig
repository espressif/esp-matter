## components/esp_matter_controller/Kconfig
```kconfig
menu "ESP Matter Controller"

    config ESP_MATTER_CONTROLLER_ENABLE
        bool "Enable matter controller"
        default n
        help
            Enable the controller.

    config ESP_MATTER_CONTROLLER_VENDOR_ID
        int "Matter Controller Vendor ID"
        depends on ESP_MATTER_CONTROLLER_ENABLE && !ESP_MATTER_ENABLE_MATTER_SERVER
        default 4891
        help
            Vendor ID for the controller

    config ESP_MATTER_COMMISSIONER_ENABLE
        bool "Enable matter commissioner"
        depends on ESP_MATTER_CONTROLLER_ENABLE && !ESP_MATTER_ENABLE_MATTER_SERVER
        default y
        help
            Enable the matter commissioner in the ESP Matter controller.

    choice ESP_MATTER_COMMISSIONER_ATTESTATION_TRUST_STORE
        prompt "Attestation Trust Store"
        depends on ESP_MATTER_COMMISSIONER_ENABLE
        default TEST_ATTESTATION_TRUST_STORE
        help
            This option determines where the commissioner reads PAA trust root certificate.

        config TEST_ATTESTATION_TRUST_STORE
            bool "Attestation Trust Store - Test"
            help
                Use the two hardcoded PAA certificates(Chip-Test-PAA-FFF1-Cert&Chip-Test-PAA-NoVID-Cert) in the firmware.

        config SPIFFS_ATTESTATION_TRUST_STORE
            bool "Attestation Trust Store - SPIFFS"
            help
                Read the PAA root certificates from the SPIFFS partition

        config DCL_ATTESTATION_TRUST_STORE
            bool "Attestation Trust Store - DCL"
            help
                Read the PAA root certificates from DCL

        config CUSTOM_ATTESTATION_TRUST_STORE
            bool "Attestation Trust Store - Custom"
            help
                Use the custom Attestation Trust Store

    endchoice

    config SPIFFS_ATTESTATION_TRUST_STORE_PARTITION_LABEL
        string "SPIFFS Attestation Trust Store Partition Label"
        depends on SPIFFS_ATTESTATION_TRUST_STORE
        default "paa_cert"
        help
            Partition Label of the SPIFFS partition to store the PAA certificates

    config ESP_MATTER_COMMISSIONER_SUPPORT_TEST_CD
        bool "Support Test Certification Declaration"
        depends on ESP_MATTER_COMMISSIONER_ENABLE
        default y
        help
            This option determines whether the commissioner supports Test CD. If this option is set to false, the
            commissioner will return CertificationDeclarationNoCertificateFound when commissioning a device using
            Test CD.

    choice ESP_MATTER_COMMISSIONER_REVOKED_DAC_CHAIN_CHECK
        prompt "Check for Revoked DAC Chain"
        depends on ESP_MATTER_COMMISSIONER_ENABLE
        default NONE_REVOKED_DAC_CHAIN_CHECK
        help
            This option determines how the commissioner checks revoked DAC chains during commissioning.

        config NONE_REVOKED_DAC_CHAIN_CHECK
            bool "Revoked DAC Chain Check - None"
            help
                None check for revoked DAC chain

        config DCL_REVOCATION_POINTS_REVOKED_DAC_CHAIN_CHECK
            bool "Revoked DAC Chain Check - DCL Revocation Points"
            help
                Use the DCL Revocation Points to check revoked DAC chain

        config CUSTOM_REVOKED_DAC_CHAIN_CHECK
            bool "Revoked DAC Chain Check - Custom"
            help
                Use the custom method to check revoked DAC chain

    endchoice

    choice ESP_MATTER_COMMISSIONER_OPERATIONAL_CREDS_ISSUER
        prompt "Operational Credentials Issuer"
        depends on !ESP_MATTER_ENABLE_MATTER_SERVER
        default TEST_OPERATIONAL_CREDS_ISSUER
        help
            This option determines how the commissioner generates the NOC chains for the end-devices and itself.

        config TEST_OPERATIONAL_CREDS_ISSUER
            bool "Operational Credentials Issuer - Test"
            help
                Use the ExampleOperationalCredentialsIssuer from Matter controller Code

        config CUSTOM_OPERATIONAL_CREDS_ISSUER
            bool "Operational Credentials Issuer - Custom"
            help
                Use the custom OperationalCredentialsIssuer

    endchoice

endmenu
```

## components/esp_matter_factory/Kconfig
```kconfig
menu "ESP Matter Factory"

    config ESP_MATTER_FACTORY_PARTITION
        string "Matter Factory Partition Name"
        default "fctry"
        help
            Partition name where the matter factory is located.

    config ESP_MATTER_FACTORY_NAMESPACE
        string "Matter Factory Namespace Name"
        default "chip_creds"

endmenu
```

## components/esp_matter_ota_provider/Kconfig
```kconfig
menu "ESP Matter OTA Provider"

    config ESP_MATTER_OTA_PROVIDER_ENABLED
        bool "Enable OTA provider"
        default n
        help
            Enable OTA provider. The OTA Provider will fetch the OTA candidates from DCL MainNet or TestNet
            and establish https connection with the ImageURI. Pass the download data to the Requestor with BDX
            Protocol.

    choice ESP_MATTER_OTA_PROVIDER_DCL_OPTION
        prompt "OTA Provider DCL options"
        depends on ESP_MATTER_OTA_PROVIDER_ENABLED
        default ESP_MATTER_OTA_PROVIDER_DCL_MAINNET
        help
            The DCL used by the OTA Provider to fetch the OTA candidates.

        config ESP_MATTER_OTA_PROVIDER_DCL_MAINNET
            bool "DCL - MainNet"
            help
                MainNet DCL, the REST URL for it is 'https://on.dcl.csa-iot.org/'

        config ESP_MATTER_OTA_PROVIDER_DCL_TESTNET
            bool "DCL - TestNet"
            help
                TestNet DCL, the REST URL for it is 'https://on.test-net.dcl.csa-iot.org/'

    endchoice

    config ESP_MATTER_MAX_OTA_CANDIDATES_COUNT
        int "OTA Provider Max Candidates Count"
        depends on ESP_MATTER_OTA_PROVIDER_ENABLED
        default 8
        help
            This value indicates the maximum count of the OTA candidates cache.

    config ESP_MATTER_OTA_CANDIDATES_UPDATE_PERIODICALLY
        bool "Update OTA Candidates Periodically"
        depends on ESP_MATTER_OTA_PROVIDER_ENABLED
        default true
        help
            Update the OTA candidates cache periodically.

    config ESP_MATTER_OTA_CANDIDATES_UPDATE_PERIOD
        int "OTA Candidates Update Period (hours)"
        depends on ESP_MATTER_OTA_CANDIDATES_UPDATE_PERIODICALLY
        range 1 480
        default 36
        help
            OTA Candidates Update Period in Hours

endmenu
```

## components/esp_matter_thread_br/Kconfig
```kconfig
menu "ESP Matter with Thread BR"
    depends on OPENTHREAD_BORDER_ROUTER

    config OPENTHREAD_BR_AUTO_UPDATE_RCP
        bool 'Update RCP automatically'
        default n
        help
            If enabled, the Thread Border Router will store the RCP image in its firmware and
            compare the stored image version with the running RCP image upon boot. The RCP
            will be automatically updated upon version mismatch.
endmenu
```

## connectedhomeip/connectedhomeip/examples/common/m5stack-tft/repo/components/spiffs/Kconfig
```kconfig
menu "TFT SPIFFS"

config SPIFFS_BASE_ADDR
    int "SPIFFS Base address"
    range 1048576 33546240
    default 0x180000
    help
	Starting address of the SPIFFS area in ESP32 Flash

config SPIFFS_SIZE
    int "SPIFFS Size in bytes"
    range 262144 2097152
    default 1048576

config SPIFFS_LOG_BLOCK_SIZE
    int "SPIFFS Logical block size"
    range 4096 65536
    default 8192

config SPIFFS_LOG_PAGE_SIZE
    int "SPIFFS Logical page size"
    range 256 2048
    default 256
    help
	Set it to the physical page size og the used SPI Flash chip.

endmenu
```

## connectedhomeip/connectedhomeip/examples/common/m5stack-tft/repo/components/tft/Kconfig
```kconfig
menu "TFT Display"

config TFT_PREDEFINED_DISPLAY_TYPE
    int
    default 0 if TFT_PREDEFINED_DISPLAY_TYPE0
    default 1 if TFT_PREDEFINED_DISPLAY_TYPE1
    default 2 if TFT_PREDEFINED_DISPLAY_TYPE2
    default 3 if TFT_PREDEFINED_DISPLAY_TYPE3
    default 4 if TFT_PREDEFINED_DISPLAY_TYPE4
    default 5 if TFT_PREDEFINED_DISPLAY_TYPE5
    default 6 if TFT_PREDEFINED_DISPLAY_TYPE6


    choice
        prompt "Select predefined display configuration"
        default TFT_PREDEFINED_DISPLAY_TYPE0
        help
            Select predefined display configuration

        config TFT_PREDEFINED_DISPLAY_TYPE0
            bool "None"
        config TFT_PREDEFINED_DISPLAY_TYPE1
            bool "ESP-WROVER-KIT v3 Display (ST7789V)"
        config TFT_PREDEFINED_DISPLAY_TYPE4
            bool "ESP-WROVER-KIT v4.1 Display (ILI9341)"
        config TFT_PREDEFINED_DISPLAY_TYPE2
            bool "Adafruit TFT Feather Display"
        config TFT_PREDEFINED_DISPLAY_TYPE3
            bool "M5Stack TFT Display"
    	config TFT_PREDEFINED_DISPLAY_TYPE5
            bool "TTGO T-DISPLAY (ST7789V)"
        config TFT_PREDEFINED_DISPLAY_TYPE6
            bool "TTGO T-WRISTBAND (ST7735)"

    endchoice

if TFT_PREDEFINED_DISPLAY_TYPE0

config TFT_DISPLAY_CONTROLLER_MODEL
    int
    default 0 if TFT_DISPLAY_CONTROLLER_ILI9341
    default 1 if TFT_DISPLAY_CONTROLLER_ILI9488
    default 2 if TFT_DISPLAY_CONTROLLER_ST7789V
    default 3 if TFT_DISPLAY_CONTROLLER_ST7735
    default 4 if TFT_DISPLAY_CONTROLLER_ST7735R
    default 5 if TFT_DISPLAY_CONTROLLER_ST7735B

    choice
        prompt "Select a display controller model."
        default TFT_DISPLAY_CONTROLLER_ILI9341
        help
          Select the controller for your display. If an TFT_PREDEFINED_DISPLAY_TYPE is set, this will be overridden.

        config TFT_DISPLAY_CONTROLLER_ILI9341
            bool "ILI9341"
        config TFT_DISPLAY_CONTROLLER_ILI9488
            bool "ILI9488"
        config TFT_DISPLAY_CONTROLLER_ST7789V
            bool "ST7789V"
        config TFT_DISPLAY_CONTROLLER_ST7735
            bool "ST7735"
        config TFT_DISPLAY_CONTROLLER_ST7735R
            bool "ST7735R"
        config TFT_DISPLAY_CONTROLLER_ST7735B
            bool "ST7735B"
    endchoice

config TFT_DISPLAY_WIDTH
    int "TFT display width in pixels."
    default 240
    help
    The smaller dimension (in portrait).

config TFT_DISPLAY_HEIGHT
    int "TFT display height in pixels."
    default 320
    help
    The smaller dimension (in portrait).

config TFT_RGB_BGR
    bool "RGB (Red Green Blue)"
    default n
    help
    Is the display RGB rather than GBR?

config TFT_TOUCH_CONTROLLER
    int
    default 0 if TFT_TOUCH_CONTROLLER0
    default 1 if TFT_TOUCH_CONTROLLER1
    default 2 if TFT_TOUCH_CONTROLLER2

    choice
        prompt "Select touch controller."
        default TFT_TOUCH_CONTROLLER0
        help
            Select predefined display configuration

        config TFT_TOUCH_CONTROLLER0
            bool "None"
        config TFT_TOUCH_CONTROLLER1
            bool "XPT2046"
        config TFT_TOUCH_CONTROLLER2
            bool "STMPE610"
    endchoice

config TFT_INVERT_ROTATION1
    bool "Invert rotation1."
    default n
    help
    If text is backwards on your display, try enabling this.

config TFT_PIN_NUM_MOSI
    int "GPIO for MOSI (Master Out Slave In)"
    default 23
    help
    If not using a predefined display type, configure the MOSI pin here.

config TFT_PIN_NUM_MISO
    int "GPIO for MISO (Master In Slave Out)"
    default 19
    help
    If not using a predefined display type, configure the MISO pin here.

config TFT_PIN_NUM_CLK
    int "GPIO for CLK (SCK / Serial Clock)"
    default 18
    help
    If not using a predefined display type, configure the SCK pin here.

config TFT_PIN_NUM_CS
    int "GPIO for CS (Slave Select)"
    default 5
    help
    If not using a predefined display type, configure the CS pin here.

config TFT_PIN_NUM_DC
    int "GPIO for DC (Data \ Command)"
    default 26
    help
    If not using a predefined display type, configure the DC pin here.

config TFT_PIN_NUM_TCS
    int "GPIO for TCS (Touchscreen)"
    default 25
    help
    Optional. If not using a predefined display type, configure the TCS (touch screen) pin here.

config TFT_PIN_NUM_RST
    int "GPIO for Reset"
    default 0
    help
    Optional. If not using a predefined display type, configure the reset pin here.

config TFT_PIN_NUM_BCKL
    int "GPIO for Back-light control"
    default 0
    help
    Optional. If not using a predefined display type, configure the blacklight pin here.

endif

endmenu
```

## connectedhomeip/connectedhomeip/examples/common/m5stack-tft/repo/main/Kconfig.projbuild
```kconfig
menu "TFT Display DEMO Configuration"

config EXAMPLE_USE_WIFI
    bool "Use wifi in TFT Demo"
    default n
    help
        If WiFi is used ntp server will be used to provide the exact time
        and file timestamps will be correct.

config WIFI_SSID
    string "WiFi SSID"
   	depends on EXAMPLE_USE_WIFI
    default "myssid"
    help
	SSID (network name) for the demo to connect to.

config WIFI_PASSWORD
    string "WiFi Password"
   	depends on EXAMPLE_USE_WIFI
    default "mypassword"
    help
	WiFi password (WPA or WPA2) for the demo to use.


endmenu
```

## connectedhomeip/connectedhomeip/examples/common/m5stack-tft/repo/sdkconfig.defaults
```kconfig
CONFIG_PARTITION_TABLE_CUSTOM=y
CONFIG_PARTITION_TABLE_CUSTOM_FILENAME="partitions_example.csv"
CONFIG_PARTITION_TABLE_CUSTOM_APP_BIN_OFFSET=0x10000
CONFIG_PARTITION_TABLE_FILENAME="partitions_example.csv"
CONFIG_APP_OFFSET=0x10000
CONFIG_ESP32_PANIC_PRINT_HALT=y
CONFIG_ESP32_DEFAULT_CPU_FREQ_240=y
CONFIG_FREERTOS_HZ=1000
CONFIG_MAIN_TASK_STACK_SIZE=8192
CONFIG_TASK_WDT_TIMEOUT_S=20
```

## connectedhomeip/connectedhomeip/third_party/pigweed/repo/Kconfig.zephyr
```kconfig
# Copyright 2021 The Pigweed Authors
#
# Licensed under the Apache License, Version 2.0 (the "License"); you may not
# use this file except in compliance with the License. You may obtain a copy of
# the License at
#
#     https://www.apache.org/licenses/LICENSE-2.0
#
# Unless required by applicable law or agreed to in writing, software
# distributed under the License is distributed on an "AS IS" BASIS, WITHOUT
# WARRANTIES OR CONDITIONS OF ANY KIND, either express or implied. See the
# License for the specific language governing permissions and limitations under
# the License.

config ZEPHYR_PIGWEED_MODULE
    select LIB_CPLUSPLUS
    depends on STD_CPP17 || STD_CPP2A || STD_CPP20 || STD_CPP2B

if ZEPHYR_PIGWEED_MODULE

rsource "pw_assert_zephyr/Kconfig"
rsource "pw_bytes/Kconfig"
rsource "pw_checksum/Kconfig"
rsource "pw_chrono_zephyr/Kconfig"
rsource "pw_containers/Kconfig"
rsource "pw_function/Kconfig"
rsource "pw_hdlc/Kconfig"
rsource "pw_interrupt_zephyr/Kconfig"
rsource "pw_log_zephyr/Kconfig"
rsource "pw_polyfill/Kconfig"
rsource "pw_preprocessor/Kconfig"
rsource "pw_result/Kconfig"
rsource "pw_router/Kconfig"
rsource "pw_rpc/Kconfig"
rsource "pw_span/Kconfig"
rsource "pw_status/Kconfig"
rsource "pw_stream/Kconfig"
rsource "pw_string/Kconfig"
rsource "pw_sync_zephyr/Kconfig"
rsource "pw_sys_io_zephyr/Kconfig"
rsource "pw_tokenizer/Kconfig"
rsource "pw_varint/Kconfig"

endif # ZEPHYR_PIGWEED_MODULE
```
