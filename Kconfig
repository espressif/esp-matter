## connectedhomeip/connectedhomeip/third_party/pigweed/repo/pw_hdlc/Kconfig
```kconfig
# Copyright 2021 The Pigweed Authors
#
# Licensed under the Apache License, Version 2.0 (the "License"); you may not
# use this file except in compliance with the License. You may obtain a copy of
# the License at
#
#     https://www.apache.org/licenses/LICENSE-2.0
#
# Unless required by applicable law or agreed to in writing, software
# distributed under the License is distributed on an "AS IS" BASIS, WITHOUT
# WARRANTIES OR CONDITIONS OF ANY KIND, either express or implied. See the
# License for the specific language governing permissions and limitations under
# the License.

config PIGWEED_HDLC
    bool "Enable Pigweed HDLC library (pw_hdlc)"
    select DEPRECATED
    select PIGWEED_HDLC_RPC

config PIGWEED_HDLC_RPC
    bool "Enable Pigweed HDLC library (pw_hdlc.pw_rpc)"
    select PIGWEED_ASSERT
    select PIGWEED_BYTES
    select PIGWEED_CHECKSUM
    select PIGWEED_RESULT
    select PIGWEED_ROUTER_PACKET_PARSER
    select PIGWEED_RPC_COMMON
    select PIGWEED_STATUS
    select PIGWEED_STREAM
    select PIGWEED_SYS_IO
    select PIGWEED_LOG
```

## connectedhomeip/connectedhomeip/third_party/pigweed/repo/pw_log_zephyr/Kconfig
```kconfig
# Copyright 2021 The Pigweed Authors
#
# Licensed under the Apache License, Version 2.0 (the "License"); you may not
# use this file except in compliance with the License. You may obtain a copy of
# the License at
#
#     https://www.apache.org/licenses/LICENSE-2.0
#
# Unless required by applicable law or agreed to in writing, software
# distributed under the License is distributed on an "AS IS" BASIS, WITHOUT
# WARRANTIES OR CONDITIONS OF ANY KIND, either express or implied. See the
# License for the specific language governing permissions and limitations under
# the License.

menuconfig PIGWEED_LOG
    bool "Enable Pigweed logging library (pw_log)"
    select PIGWEED_PREPROCESSOR
    help
      Once the Pigweed logging is enabled, all Pigweed logs via PW_LOG_*() will
      go to the "pigweed" Zephyr logging module.

if PIGWEED_LOG

module = PIGWEED
module-str = "pigweed"
source "subsys/logging/Kconfig.template.log_config"

endif # PIGWEED_LOG
```

## connectedhomeip/connectedhomeip/third_party/pigweed/repo/pw_router/Kconfig
```kconfig
# Copyright 2021 The Pigweed Authors
#
# Licensed under the Apache License, Version 2.0 (the "License"); you may not
# use this file except in compliance with the License. You may obtain a copy of
# the License at
#
#     https://www.apache.org/licenses/LICENSE-2.0
#
# Unless required by applicable law or agreed to in writing, software
# distributed under the License is distributed on an "AS IS" BASIS, WITHOUT
# WARRANTIES OR CONDITIONS OF ANY KIND, either express or implied. See the
# License for the specific language governing permissions and limitations under
# the License.

config PIGWEED_ROUTER_STATIC_ROUTER
    bool "Enable the Pigweed static router library (pw_router.static_router)"
    select PIGWEED_METRIC
    select PIGWEED_ROUTER_EGRESS
    select PIGWEED_ROUTER_PACKET_PARSER
    select PIGWEED_SYNC_MUTEX
    select PIGWEED_LOG

config PIGWEED_ROUTER_EGRESS
    bool "Enable the Pigweed router egress library (pw_router.egress)"
    select PIGWEED_BYTES

config PIGWEED_ROUTER_PACKET_PARSER
    bool "Enable the Pigweed router packet parser library (pw_router.packet_parser)"
    select PIGWEED_BYTES

config PIGWEED_ROUTER_EGRESS_FUNCTION
    bool "Enable the Pigweed router egress function library (pw_router.egress_function)"
    select PIGWEED_RPC_EGRESS
```

## connectedhomeip/connectedhomeip/third_party/pigweed/repo/pw_rpc/Kconfig
```kconfig
# Copyright 2021 The Pigweed Authors
#
# Licensed under the Apache License, Version 2.0 (the "License"); you may not
# use this file except in compliance with the License. You may obtain a copy of
# the License at
#
#     https://www.apache.org/licenses/LICENSE-2.0
#
# Unless required by applicable law or agreed to in writing, software
# distributed under the License is distributed on an "AS IS" BASIS, WITHOUT
# WARRANTIES OR CONDITIONS OF ANY KIND, either express or implied. See the
# License for the specific language governing permissions and limitations under
# the License.

rsource "nanopb/Kconfig"

config PIGWEED_RPC_SERVER
    bool "Enable Pigweed RPC server library (pw_rpc.server)"
    select PIGWEED_RPC_COMMON
    select PIGWEED_LOG

config PIGWEED_RPC_CLIENT
    bool "Enable Pigweed RPC client library (pw_rpc.client)"
    select PIGWEED_RPC_COMMON
    select PIGWEED_RESULT
    select PIGWEED_LOG

config PIGWEED_RPC_CLIENT_SERVER
    bool "Enable Pigweed RPC client-server library (pw_rpc.client_server)"
    select PIGWEED_RPC_CLIENT
    select PIGWEED_RPC_SERVER

config PIGWEED_RPC_COMMON
    bool "Enable Pigweed RPC common library (pw_rpc.common)"
    select PIGWEED_ASSERT
    select PIGWEED_BYTES
    select PIGWEED_CONTAINERS
    select PIGWEED_FUNCTION
    select PIGWEED_SPAN
    select PIGWEED_STATUS
    select PIGWEED_LOG
    select PIGWEED_SYNC_MUTEX
```

## connectedhomeip/connectedhomeip/third_party/pigweed/repo/pw_rpc/nanopb/Kconfig
```kconfig
# Copyright 2021 The Pigweed Authors
#
# Licensed under the Apache License, Version 2.0 (the "License"); you may not
# use this file except in compliance with the License. You may obtain a copy of
# the License at
#
#     https://www.apache.org/licenses/LICENSE-2.0
#
# Unless required by applicable law or agreed to in writing, software
# distributed under the License is distributed on an "AS IS" BASIS, WITHOUT
# WARRANTIES OR CONDITIONS OF ANY KIND, either express or implied. See the
# License for the specific language governing permissions and limitations under
# the License.

menuconfig PIGWEED_RPC_NANOPB
    bool "Pigweed RPC nanobp"

if PIGWEED_RPC_NANOPB

config PIGWEED_RPC_NANOPB_DIR
    string "Optional 3rd party directory for nanopb"
    help
      The directory for the custom nanopb build rules to integrate with pigweed.

config PIGWEED_RPC_NANOPB_METHOD
    bool "Enable Pigweed RPC/Nanopb method library (pw_rpc.nanopb.method)"
    select PIGWEED_RPC_NANOPB_COMMON
    select PIGWEED_RPC_SERVER
    select PIGWEED_LOG

config PIGWEED_RPC_NANOPB_METHOD_UNION
    bool "Enable Pigweed RPC/Nanopb method union library (pw_rpc.nanopb.method_union)"
    select PIGWEED_RPC_NANOPB_METHOD
    select PIGWEED_RPC_RAW
    select PIGWEED_RPC_SERVER
    select PIGWEED_LOG

config PIGWEED_RPC_NANOPB_CLIENT
    bool "Enable Pigweed RPC/Nanopb client library (pw_rpc.nanopb.client)"
    select PIGWEED_FUNCTION
    select PIGWEED_RPC_NANOPB_COMMON
    select PIGWEED_RPC_COMMON

config PIGWEED_RPC_NANOPB_COMMON
    bool "Enable Pigweed RPC/Nanopb common library (pw_rpc.nanopb.common)"
    select PIGWEED_BYTES
    select PIGWEED_LOG
    select PIGWEED_RPC_COMMON

config PIGWEED_RPC_NANOPB_ECHO_SERVICE
    bool "Enable Pigweed RPC/Nanopb echo service library (pw_rpc.nanopb.echo_service)"

endif # PIGWEED_RPC_NANOPB
```

## connectedhomeip/connectedhomeip/third_party/pigweed/repo/pw_sync_zephyr/Kconfig
```kconfig
# Copyright 2021 The Pigweed Authors
#
# Licensed under the Apache License, Version 2.0 (the "License"); you may not
# use this file except in compliance with the License. You may obtain a copy of
# the License at
#
#     https://www.apache.org/licenses/LICENSE-2.0
#
# Unless required by applicable law or agreed to in writing, software
# distributed under the License is distributed on an "AS IS" BASIS, WITHOUT
# WARRANTIES OR CONDITIONS OF ANY KIND, either express or implied. See the
# License for the specific language governing permissions and limitations under
# the License.

config PIGWEED_SYNC
    bool
    select PIGWEED_CHRONO_SYSTEM_CLOCK
    select PIGWEED_PREPROCESSOR
    select PIGWEED_INTERRUPT_CONTEXT

config PIGWEED_SYNC_MUTEX
    bool "Enable Pigweed mutex library (pw_sync.mutex)"
    select PIGWEED_SYNC
    select PIGWEED_POLYFILL

config PIGWEED_SYNC_BINARY_SEMAPHORE
    bool "Enable Pigweed binary semaphore library (pw_sync.binary_semaphore)"
    select PIGWEED_SYNC
```

## connectedhomeip/connectedhomeip/third_party/pigweed/repo/pw_sys_io_zephyr/Kconfig
```kconfig
# Copyright 2021 The Pigweed Authors
#
# Licensed under the Apache License, Version 2.0 (the "License"); you may not
# use this file except in compliance with the License. You may obtain a copy of
# the License at
#
#     https://www.apache.org/licenses/LICENSE-2.0
#
# Unless required by applicable law or agreed to in writing, software
# distributed under the License is distributed on an "AS IS" BASIS, WITHOUT
# WARRANTIES OR CONDITIONS OF ANY KIND, either express or implied. See the
# License for the specific language governing permissions and limitations under
# the License.

config PIGWEED_SYS_IO
    bool "Enable the Zephyr system IO module"
    select PIGWEED_SPAN
    select PIGWEED_STATUS
    help
      The system I/O module uses the Zephyr console under the hood to perform
      I/O operations.

if PIGWEED_SYS_IO

config PIGWEED_SYS_IO_INIT_PRIORITY
    int "The initialization priority of the system I/O module"
    default 1
    help
      The system I/O module uses the APPLICATION initialization level. Use this
      config to set the priority.

config PIGWEED_SYS_IO_USB
    bool "Use the USB for I/O"

endif # PIGWEED_SYS_IO
```

## connectedhomeip/connectedhomeip/third_party/pigweed/repo/pw_tokenizer/Kconfig
```kconfig
# Copyright 2022 The Pigweed Authors
#
# Licensed under the Apache License, Version 2.0 (the "License"); you may not
# use this file except in compliance with the License. You may obtain a copy of
# the License at
#
#     https://www.apache.org/licenses/LICENSE-2.0
#
# Unless required by applicable law or agreed to in writing, software
# distributed under the License is distributed on an "AS IS" BASIS, WITHOUT
# WARRANTIES OR CONDITIONS OF ANY KIND, either express or implied. See the
# License for the specific language governing permissions and limitations under
# the License.

config PIGWEED_TOKENIZER
  bool "Enable the pw_tokenizer library"
  select PIGWEED_CONTAINERS
  select PIGWEED_PREPROCESSOR
  select PIGWEED_SPAN
  select PIGWEED_VARINT

config PIGWEED_TOKENIZER_BASE64
  bool "Enable the pw_tokenizer.base64 library"
  select PIGWEED_TOKENIZER
  select PIGWEED_BASE64
  select PIGWEED_SPAN

config PIGWEED_DETOKENIZER
  bool "Enable the pw_tokenizer.decoder library"
  select PIGWEED_TOKENIZER
  select PIGWEED_SPAN
  select PIGWEED_BYTES
  select PIGWEED_VARINT
```

## dqsmart_dev/light_bulb/sdkconfig.defaults
```kconfig
# Default to 921600 baud when flashing and monitoring device
CONFIG_ESPTOOLPY_BAUD_921600B=y
CONFIG_ESPTOOLPY_BAUD=921600
CONFIG_ESPTOOLPY_COMPRESSED=y
CONFIG_ESPTOOLPY_MONITOR_BAUD_115200B=y
CONFIG_ESPTOOLPY_MONITOR_BAUD=115200
CONFIG_ESPTOOLPY_FLASHSIZE_4MB=y

#enable BT
CONFIG_BT_ENABLED=y
CONFIG_BT_NIMBLE_ENABLED=y

#disable BT connection reattempt
CONFIG_BT_NIMBLE_ENABLE_CONN_REATTEMPT=n

#enable lwip ipv6 autoconfig
CONFIG_LWIP_IPV6_AUTOCONFIG=y

# Use a custom partition table
CONFIG_PARTITION_TABLE_CUSTOM=y
CONFIG_PARTITION_TABLE_FILENAME="partitions.csv"
CONFIG_PARTITION_TABLE_OFFSET=0xC000

# Enable chip shell
CONFIG_ENABLE_CHIP_SHELL=y

#enable lwIP route hooks
CONFIG_LWIP_HOOK_IP6_ROUTE_DEFAULT=y
CONFIG_LWIP_HOOK_ND6_GET_GW_DEFAULT=y

# Button
CONFIG_BUTTON_PERIOD_TIME_MS=20
CONFIG_BUTTON_LONG_PRESS_TIME_MS=5000

# disable softap by default
CONFIG_ESP_WIFI_SOFTAP_SUPPORT=n

# Disable DS Peripheral
CONFIG_ESP_SECURE_CERT_DS_PERIPHERAL=n
```

## examples/all_device_types_app/main/Kconfig.projbuild
```kconfig
menu "App Driver Configuration"
menu "Fan driver configuration"

    menu "upper switch config"
        config UPPER_SWITCH_PHASE_U_GPIO
            int "upper switch PHASE_U GPIO"
            default 25 if IDF_TARGET_ESP32
            default 17 if IDF_TARGET_ESP32S3
            default 17
        config UPPER_SWITCH_PHASE_V_GPIO
            int "upper switch PHASE_V GPIO"
            default 26 if IDF_TARGET_ESP32
            default 16 if IDF_TARGET_ESP32S3
            default 16
        config UPPER_SWITCH_PHASE_W_GPIO
            int "upper switch PHASE_W GPIO"
            default 27 if IDF_TARGET_ESP32
            default 15 if IDF_TARGET_ESP32S3
            default 15
    endmenu

    menu "lower switch config"
        config LOWER_SWITCH_PHASE_U_GPIO
            int "lower switch PHASE_U GPIO"
            default 16 if IDF_TARGET_ESP32
            default 12 if IDF_TARGET_ESP32S3
            default 12
        config LOWER_SWITCH_PHASE_V_GPIO
            int "lower switch PHASE_V GPIO"
            default 17 if IDF_TARGET_ESP32
            default 11 if IDF_TARGET_ESP32S3
            default 11
        config LOWER_SWITCH_PHASE_W_GPIO
            int "lower switch PHASE_W GPIO"
            default 5 if IDF_TARGET_ESP32
            default 10 if IDF_TARGET_ESP32S3
            default 10

    endmenu

    menu "zero cross comparer config"
        config ZERO_CROSS_COMPARER_PHASE_U_GPIO
            int "zero cross comparer PHASE_U GPIO"
            default 3 if IDF_TARGET_ESP32
            default 3 if IDF_TARGET_ESP32S3
            default 3
        config ZERO_CROSS_COMPARER_PHASE_V_GPIO
            int "zero cross comparer PHASE_V GPIO"
            default 18 if IDF_TARGET_ESP32
            default 46 if IDF_TARGET_ESP32S3
            default 46
        config ZERO_CROSS_COMPARER_PHASE_W_GPIO
            int "zero cross comparer PHASE_W GPIO"
            default 2 if IDF_TARGET_ESP32
            default 9 if IDF_TARGET_ESP32S3
            default 9
    endmenu

    menu "Step motor config"
        config STEP_MOTOR_A0_GPIO
            int "Step motor A+ GPIO"
            default 12 if IDF_TARGET_ESP32
            default 14 if IDF_TARGET_ESP32S3
            default 14
        config STEP_MOTOR_A1_GPIO
            int "Step motor A- GPIO"
            default 13 if IDF_TARGET_ESP32
            default 21 if IDF_TARGET_ESP32S3
            default 21
        config STEP_MOTOR_B0_GPIO
            int "Step motor B+ GPIO"
            default 14 if IDF_TARGET_ESP32
            default 47 if IDF_TARGET_ESP32S3
            default 47
        config STEP_MOTOR_B1_GPIO
            int "Step motor B- GPIO"
            default 15 if IDF_TARGET_ESP32
            default 48 if IDF_TARGET_ESP32S3
            default 48
    endmenu

    config POWER_BUTTON_GPIO
        int "Power Button GPIO"
        default 0

endmenu
endmenu

menu "Example Configuration"
     config ENABLE_MEMORY_PROFILING
          bool "Enable Memory Profiling"
          default n
          help
             Enable this option to include memory profiling features in the example.
             This will allow you to monitor memory usage during runtime.

endmenu

menu "Platform Diagnostics"

    config END_USER_BUFFER_SIZE
        int "Set buffer size for end user diagnostic data"
        depends on ENABLE_ESP_DIAGNOSTICS_TRACE
        default 4096
        help
            Defines the buffer size (in bytes) for storing diagnostic data related to end user activity.
            This buffer will hold logs and traces relevant to user interactions with the Matter protocol.

    config RETRIEVAL_BUFFER_SIZE
        int "Set buffer size for retrieval of diagnostics from diagnostic storage"
        depends on ENABLE_ESP_DIAGNOSTICS_TRACE
        default 4096
        help
            Defines the buffer size (in bytes) for retrieval of diagnostic data.
endmenu
```
