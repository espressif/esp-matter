/*
 * Copyright (c) 2018, Texas Instruments Incorporated
 * All rights reserved.
 *
 * Redistribution and use in source and binary forms, with or without
 * modification, are permitted provided that the following conditions
 * are met:
 *
 * *  Redistributions of source code must retain the above copyright
 *    notice, this list of conditions and the following disclaimer.
 *
 * *  Redistributions in binary form must reproduce the above copyright
 *    notice, this list of conditions and the following disclaimer in the
 *    documentation and/or other materials provided with the distribution.
 *
 * *  Neither the name of Texas Instruments Incorporated nor the names of
 *    its contributors may be used to endorse or promote products derived
 *    from this software without specific prior written permission.
 *
 * THIS SOFTWARE IS PROVIDED BY THE COPYRIGHT HOLDERS AND CONTRIBUTORS "AS IS"
 * AND ANY EXPRESS OR IMPLIED WARRANTIES, INCLUDING, BUT NOT LIMITED TO,
 * THE IMPLIED WARRANTIES OF MERCHANTABILITY AND FITNESS FOR A PARTICULAR
 * PURPOSE ARE DISCLAIMED. IN NO EVENT SHALL THE COPYRIGHT OWNER OR
 * CONTRIBUTORS BE LIABLE FOR ANY DIRECT, INDIRECT, INCIDENTAL, SPECIAL,
 * EXEMPLARY, OR CONSEQUENTIAL DAMAGES (INCLUDING, BUT NOT LIMITED TO,
 * PROCUREMENT OF SUBSTITUTE GOODS OR SERVICES; LOSS OF USE, DATA, OR PROFITS;
 * OR BUSINESS INTERRUPTION) HOWEVER CAUSED AND ON ANY THEORY OF LIABILITY,
 * WHETHER IN CONTRACT, STRICT LIABILITY, OR TORT (INCLUDING NEGLIGENCE OR
 * OTHERWISE) ARISING IN ANY WAY OUT OF THE USE OF THIS SOFTWARE,
 * EVEN IF ADVISED OF THE POSSIBILITY OF SUCH DAMAGE.
 */
// @cliArgs --board /ti/boards/LP_CC2652R7 --rtos tirtos

/*
 *  project_zero.syscfg
 */

const lpName = system.getScript("/ti/ble5stack/ble_common.js").getBoardOrLaunchPadName(true);

/* ======== RTOS ======== */
var RTOS = scripting.addModule("/ti/drivers/RTOS");

/* ======== AESCCM ======== */
var AESCCM = scripting.addModule("/ti/drivers/AESCCM");
var aesccm = AESCCM.addInstance();
aesccm.$name = "CONFIG_AESCCM0";

/* ======== AESECB ======== */
var AESECB = scripting.addModule("/ti/drivers/AESECB");
var aesecb = AESECB.addInstance();
aesecb.$name = "CONFIG_AESECB0";

/* ======== ECDH ======== */
var ECDH = scripting.addModule("/ti/drivers/ECDH");
var ecdh = ECDH.addInstance();
ecdh.$name = "CONFIG_ECDH0"

/* ======== AESCTRDRBG ======== */
var AESCTRDRBG = scripting.addModule("/ti/drivers/AESCTRDRBG");
var aesctrdrbg = AESCTRDRBG.addInstance();
aesctrdrbg.$name = "CONFIG_AESCTRDRBG_0";
aesctrdrbg.aesctrObject.$name = "CONFIG_AESCTR_0";

/* ======== Display ======== */
var Display = scripting.addModule("/ti/display/Display");
var displayUART = Display.addInstance();
displayUART.$hardware = system.deviceData.board.components.XDS110UART;
displayUART.enableANSI = true;
displayUART.uartBufferSize = 128;
displayUART.useUART2 = false;
displayUART.uart.txPinInstance.outputState = "High";
displayUART.uart.$name = "CONFIG_DISPLAY_UART";
displayUART.uart.txPinInstance.$name = "CONFIG_PIN_UART_TX";
displayUART.uart.rxPinInstance.$name = "CONFIG_PIN_UART_RX";

/* ======== GPIO ======== */
var GPIO = scripting.addModule("/ti/drivers/PIN");

var gpio0 = GPIO.addInstance();
gpio0.$hardware = system.deviceData.board.components.BUTTON0;
gpio0.mode = "Input";
gpio0.$name = "CONFIG_GPIO_BTN1";

var gpio1 = GPIO.addInstance();
gpio1.$hardware = system.deviceData.board.components.BUTTON1;
gpio1.mode = "Input";
gpio1.$name = "CONFIG_GPIO_BTN2";

var gpio2 = GPIO.addInstance();
gpio2.$hardware = system.deviceData.board.components.LED0;
gpio2.mode = "Output";
gpio2.$name = "CONFIG_PIN_RLED";

var gpio3 = GPIO.addInstance();
gpio3.$hardware = system.deviceData.board.components.LED1;
gpio3.mode = "Output";
gpio3.$name = "CONFIG_PIN_GLED";

/* ======== NVS ======== */
var NVS = scripting.addModule("/ti/drivers/NVS");

var nvsInt = NVS.addInstance();
nvsInt.internalFlash.regionBase   = 0x48000;
nvsInt.internalFlash.regionSize   = 0x4000;
nvsInt.$name = "CONFIG_NVSINTERNAL";

var nvsExt = NVS.addInstance();
nvsExt.$hardware = system.deviceData.board.components.MX25R8035F;
nvsExt.$name = "CONFIG_NVSEXTERNAL";
nvsExt.externalFlash.regionSize = 1048576;
// Verify Buffer Size - Size of the write verification buffer in bytes.
nvsExt.externalFlash.verifyBufferSize = 64;

/* ======== RF ======== */
var RF = scripting.addModule("/ti/drivers/RF");

/* if an antenna component exists, assign it to the rf instance */
if (system.deviceData.board && system.deviceData.board.components.RF) {
    RF.$hardware = system.deviceData.board.components.RF;
}

/* ======== POWER ======== */
var Power = scripting.addModule("/ti/drivers/Power");

if(lpName == "LP_CC2652RB")
{
  RF.xoscNeeded = false;
  Power.calibrateRCOSC_HF = false;
}
/* ======== TRNG ======== */
var TRNG = scripting.addModule("/ti/drivers/TRNG");
var trng = TRNG.addInstance();

/* ======== Device ======== */
// Temporarily disable ti_devices_config.c generation
var device = scripting.addModule("ti/devices/CCFG");
device.enableCodeGeneration = false;

/* ======== RF Design ======== */
var rfDesign = scripting.addModule("ti/devices/radioconfig/rfdesign");
const rfDesignSettings = system.getScript("/ti/common/lprf_rf_design_settings.js").rfDesignSettings;
for(var setting in rfDesignSettings)
{
    rfDesign[setting] = rfDesignSettings[setting];
}

const radioSettings = system.getScript("/ti/ble5stack/ble_common.js").getRadioScript(rfDesign.rfDesign,system.deviceData.deviceId);
const bleRfDesignSettings = radioSettings.rfDesignParams;
for(var setting in bleRfDesignSettings)
{
    rfDesign[setting] = bleRfDesignSettings[setting];
}

/* ======== BLE ======== */
var ble = scripting.addModule("/ti/ble5stack/ble");
ble.rfDesign = rfDesignSettings.rfDesign;
ble.deviceRole = "PERIPHERAL_CFG";
ble.lockProject = true;
ble.oadProject = true;
ble.hidePtm = true;
if(lpName == "LP_CC2652RB")
{
    ble.deviceName = "Project Zero BAW"
}
else
{
    ble.deviceName = "Project Zero";
}
ble.addressMode = "ADDRMODE_PUBLIC";

// Disable the Display Module
ble.disableDisplayModule = true;
ble.uartLog = true;

// Maximum size of PDU (bytes)
ble.maxPDUSize = 251;
// Maximum Number of Connections
ble.maxConnNum = 2;

// Update Connection Timeout (ms)
ble.connUpdateParamsPeripheral.reqConnTo = 2000;
// Update Max Connection Interval (ms)
ble.connUpdateParamsPeripheral.reqMaxConnInt = 45;
// Update Min Connection Interval (ms)
ble.connUpdateParamsPeripheral.reqMinConnInt = 15;

// Number of Advertisement Sets
ble.numOfAdvSets = 1;
ble.numOfDefAdvSets = 1;
// Gap Advertising Flags
ble.advSet1.advData1.GAP_ADTYPE_FLAGS = true;
// Advertising Flags
ble.advSet1.advData1.advertisingFlags = ["GAP_ADTYPE_FLAGS_BREDR_NOT_SUPPORTED","GAP_ADTYPE_FLAGS_GENERAL"];
// Complete local name
ble.advSet1.advData1.GAP_ADTYPE_LOCAL_NAME_COMPLETE = true;
// More 128-bit UUIDs available
ble.advSet1.scanRes1.GAP_ADTYPE_128BIT_MORE = true;
// Num of UUIDs (128-bit More)
ble.advSet1.scanRes1.numOfUUIDs128More = 1;
// UUID 0 (128-bit More)
ble.advSet1.scanRes1.UUID0128More = system.utils.bigInt("B000405104101100F0",16);
