## examples/all_device_types_app/sdkconfig.defaults.wifi_thread
```kconfig
# libsodium
CONFIG_LIBSODIUM_USE_MBEDTLS_SHA=y

# NIMBLE
CONFIG_BT_ENABLED=y
CONFIG_BT_NIMBLE_ENABLED=y
CONFIG_BT_NIMBLE_EXT_ADV=n
CONFIG_BT_NIMBLE_HCI_EVT_BUF_SIZE=70
CONFIG_USE_BLE_ONLY_FOR_COMMISSIONING=n

# Enable OpenThread
CONFIG_OPENTHREAD_ENABLED=y
CONFIG_OPENTHREAD_SRP_CLIENT=y
CONFIG_OPENTHREAD_DNS_CLIENT=y
CONFIG_OPENTHREAD_LOG_LEVEL_DYNAMIC=n
CONFIG_OPENTHREAD_LOG_LEVEL_NOTE=y
CONFIG_OPENTHREAD_CLI=y
CONFIG_OPENTHREAD_PLATFORM_MSGPOOL_MANAGEMENT=y

# Disable lwip ipv6 autoconfig
CONFIG_LWIP_IPV6_AUTOCONFIG=n

# Use a custom partition table (larger app slots than partitions.csv for Wi-Fi + Thread build)
CONFIG_PARTITION_TABLE_CUSTOM=y
CONFIG_PARTITION_TABLE_CUSTOM_FILENAME="partitions.c6.csv"

# LwIP config for OpenThread
CONFIG_LWIP_IPV6_NUM_ADDRESSES=8
CONFIG_LWIP_MULTICAST_PING=y

# MDNS platform
CONFIG_USE_MINIMAL_MDNS=n
CONFIG_ENABLE_EXTENDED_DISCOVERY=y

# Enable OTA Requestor
CONFIG_ENABLE_OTA_REQUESTOR=y

# Enable Wi-Fi Station
CONFIG_ENABLE_WIFI_STATION=y

# Button
CONFIG_BUTTON_PERIOD_TIME_MS=20
CONFIG_BUTTON_LONG_PRESS_TIME_MS=5000

# Enable chip shell
CONFIG_ENABLE_CHIP_SHELL=y

# This example use 3 dynamic endpoints: RootNode, light, and secondary network commissioning
CONFIG_ESP_MATTER_MAX_DYNAMIC_ENDPOINT_COUNT=3

# Firmware size optimization
CONFIG_COMPILER_OPTIMIZATION_SIZE=y
CONFIG_COMPILER_OPTIMIZATION_ASSERTIONS_SILENT=y
CONFIG_COMPILER_OPTIMIZATION_CHECKS_SILENT=y
CONFIG_COMPILER_SAVE_RESTORE_LIBCALLS=y
CONFIG_NEWLIB_NANO_FORMAT=y
CONFIG_ESP_ERR_TO_NAME_LOOKUP=n
```

## examples/bridge_apps/dali_bridge/main/Kconfig.projbuild
```kconfig
menu "Example Configuration"

    config ENABLE_MEMORY_PROFILING
        bool "Enable Memory Profiling"
        default n
        help
            Enable this option to include memory profiling features in the example.
            This will allow you to monitor memory usage during runtime.

    menu "DALI Configuration"

        config DALI_RX_GPIO
            int "DALI RX GPIO number"
            default 5
            help
                GPIO connected to the DALI bus RX signal.

        config DALI_TX_GPIO
            int "DALI TX GPIO number"
            default 4 if IDF_TARGET_ESP32 || IDF_TARGET_ESP32H2
            default 6
            help
                GPIO connected to the DALI bus TX signal.
                GPIO4 is the default on ESP32 (GPIO6 is used by the SPI flash)
                and on ESP32-H2 (GPIO6 is not broken out on the DevKitM-1).

        config DALI_TX_INVERT
            bool "Invert DALI TX signal"
            default y
            help
                Enable this if the TX hardware path performs an odd number of
                signal inversions (e.g. an inverting bus transceiver).

        config DALI_RX_INVERT
            bool "Invert DALI RX signal"
            default y
            help
                Enable this if the RX hardware path performs an odd number of
                signal inversions (e.g. an inverting optocoupler).

    endmenu

endmenu
```

## examples/door_lock/main/Kconfig.projbuild
```kconfig
menu "Example Configuration"

    choice DOOR_LOCK_NFC_FEATURE
        prompt "NFC feature"
        default DOOR_LOCK_NFC_FEATURE_NONE
        help
            The M5Unit-NFC (ST25R3916) hardware only supports one active reader
            role at a time, so Aliro-over-NFC and the classic RFID/NFC-tag
            credential feature are mutually exclusive.

        config DOOR_LOCK_NFC_FEATURE_NONE
            bool "None"

        config ENABLE_ALIRO_OVER_NFC
            bool "Aliro-over-NFC"
            help
                Enable this option to enable Aliro-over-NFC feature for DoorLock cluster.

        config ENABLE_RFID_NFC
            bool "Classic RFID/NFC-tag credential"
            help
                Enable this option to poll for classic NFC tags (ISO14443A/B, FeliCa,
                ISO15693) with the M5Stack Unit NFC (ST25R3916) and unlock the door
                when a tag's UID matches a provisioned RFID credential.
    endchoice

    config M5NANO_BOARD
        bool "Use an M5Stack Nano board"
        default n
        depends on IDF_TARGET_ESP32C6 || IDF_TARGET_ESP32H2
        help
            Enable board-specific handling for M5Stack NanoC6 and NanoH2,
            including the RGB LED power-enable GPIO.

    config M5NANO_STATUS_LED_POWER_GPIO
        int
        depends on M5NANO_BOARD
        default 19 if IDF_TARGET_ESP32C6
        default 10 if IDF_TARGET_ESP32H2

endmenu
```

## examples/light_switch/sdkconfig.defaults.c6_thread
```kconfig
CONFIG_IDF_TARGET="esp32c6"
CONFIG_ESPTOOLPY_FLASHSIZE_4MB=y

#enable BT
CONFIG_BT_ENABLED=y
CONFIG_BT_NIMBLE_ENABLED=y

#disable BT connection reattempt
CONFIG_BT_NIMBLE_ENABLE_CONN_REATTEMPT=n

# Use a custom partition table
CONFIG_PARTITION_TABLE_CUSTOM=y
CONFIG_PARTITION_TABLE_FILENAME="partitions.csv"
CONFIG_PARTITION_TABLE_OFFSET=0xC000

# Enable chip shell
CONFIG_ENABLE_CHIP_SHELL=y

# This example only use 2 dynamic endpoints
CONFIG_ESP_MATTER_MAX_DYNAMIC_ENDPOINT_COUNT=2

CONFIG_ENABLE_WIFI_AP=n

#enable lwIP route hooks
CONFIG_LWIP_HOOK_IP6_ROUTE_DEFAULT=y
CONFIG_LWIP_HOOK_ND6_GET_GW_DEFAULT=y

# Button
CONFIG_BUTTON_PERIOD_TIME_MS=20
CONFIG_BUTTON_LONG_PRESS_TIME_MS=5000

# disable softap by default
CONFIG_ESP_WIFI_SOFTAP_SUPPORT=n

# Enable OTA Requestor
CONFIG_ENABLE_OTA_REQUESTOR=y

# Enable HKDF in mbedtls
CONFIG_MBEDTLS_HKDF_C=y

# Enable OpenThread
CONFIG_OPENTHREAD_ENABLED=y
CONFIG_OPENTHREAD_SRP_CLIENT=y
CONFIG_OPENTHREAD_LOG_LEVEL_DYNAMIC=n
CONFIG_OPENTHREAD_LOG_LEVEL_NOTE=y
CONFIG_OPENTHREAD_CLI=n

# Disable lwip ipv6 autoconfig
CONFIG_LWIP_IPV6_AUTOCONFIG=n

# LwIP config for OpenThread
CONFIG_LWIP_IPV6_NUM_ADDRESSES=8
CONFIG_LWIP_MULTICAST_PING=y

# MDNS platform
CONFIG_USE_MINIMAL_MDNS=n

# Disable STA for ESP32C6
CONFIG_ENABLE_WIFI_STATION=n

# ESP32-C6-DevKitM-1 Settings
# Buttons
CONFIG_BSP_BUTTONS_NUM=1
CONFIG_BSP_BUTTON_1_TYPE_GPIO=y
CONFIG_BSP_BUTTON_1_GPIO=9
CONFIG_BSP_BUTTON_1_LEVEL=0
```

## examples/thread_border_router/main/Kconfig.projbuild
```kconfig
menu "Thread Border Router Example"

    config ENABLE_NETWORK_INFRASTRUCTURE_MANAGER
        bool "Use the Network Infrastructure Manager device type instead of Thread Border Router"
        default n
        help
            The "Network Infrastructure Manager" (NIM) Matter device type is a superset of
            "Thread Border Router": it exposes the same ThreadBorderRouterManagement cluster
            (and ThreadNetworkDiagnostics, if Thread is enabled), plus WiFiNetworkManagement
            and ThreadNetworkDirectory.

            Enable this to advertise the endpoint as a Network Infrastructure Manager instead
            of a plain Thread Border Router. Left disabled by default to preserve this
            example's existing behavior.

endmenu
```
